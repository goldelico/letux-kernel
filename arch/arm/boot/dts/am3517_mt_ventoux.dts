/*
 * Copyright (C) 2011 Ilya Yanok, EmCraft Systems
 *
 * This program is free software; you can redistribute it and/or modify
 * it under the terms of the GNU General Public License version 2 as
 * published by the Free Software Foundation.
 */
/dts-v1/;

/include/ "omap34xx.dtsi"

/ {
	model = "TeeJet Mt.Ventoux";
	compatible = "teejet,mt_ventoux", "ti,omap3";

	memory {
		device_type = "memory";
		reg = <0x80000000 0x10000000>; /* 256 MB */
	};

	/* AM35xx doesn't have IVA */
	soc {
		iva {
			status = "disabled";
		};
	};
};

&omap_control_mmc1 {
	compatible = "ti,omap-hsmmc-control";
	ctrl-type = <0>;
};

omap_control_mmc2: omap-hsmmc-control@480022D8 {
	compatible = "ti,omap-hsmmc-control";
	reg = <0x480022D8 0x4>;
	reg-names = "devconf1";
	ctrl-type = <2>;
};

&mmc1 {
	bus-width = <8>;
};

&mmc2 {
	status = "disabled";
};
