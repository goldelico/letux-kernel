/*
 * Copyright (C) 2013 Texas Instruments Incorporated - http://www.ti.com/
 *
 * This program is free software; you can redistribute it and/or modify
 * it under the terms of the GNU General Public License version 2 as
 * published by the Free Software Foundation.
 */

#include "dra7-evm.dts"
#include "dra7xx-evm-lcd10.dtsi"

/* override pinmux for tsc irq line on dra74x */
&tsc_pins {
	pinctrl-single,pins = <
		0x420 (PIN_INPUT_PULLDOWN | MUX_MODE14) /* gpio1_2 */
	>;
};

&ldc3001 {
	interrupt-parent = <&gpio1>;
	interrupts = <2 IRQ_TYPE_LEVEL_HIGH>;
	pinctrl-0 = <&tsc_pins>;
};
