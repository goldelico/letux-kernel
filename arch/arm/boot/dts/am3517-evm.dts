/*
 * Copyright (C) 2011 Texas Instruments Incorporated - http://www.ti.com/
 *
 * This program is free software; you can redistribute it and/or modify
 * it under the terms of the GNU General Public License version 2 as
 * published by the Free Software Foundation.
 */
/dts-v1/;

/include/ "omap34xx.dtsi"

/ {
	model = "TI AM3517 EVM (AM3517/05)";
	compatible = "ti,am3517-evm", "ti,omap3";

	memory {
		device_type = "memory";
		reg = <0x80000000 0x10000000>; /* 256 MB */
	};
};

&i2c1 {
	clock-frequency = <400000>;
};

&i2c2 {
	clock-frequency = <400000>;
};

&i2c3 {
	clock-frequency = <400000>;
};

&omap_control_mmc1 {
	compatible = "ti,omap-hsmmc-control";
	ctrl-type = <0>;
};

omap_control_mmc2: omap-hsmmc-control@480022D8 {
	compatible = "ti,omap-hsmmc-control";
	reg = <0x480022D8 0x4>;
	reg-names = "devconf1";
	ctrl-type = <2>;
};

&mmc1 {
	bus-width = <8>;
};

&mmc2 {
	status = "disabled";
};
