## arch/mips/xburst/Kconfig
```kconfig
menuconfig SOC_TYPE
	tristate "SOC type"
	depends on MACH_XBURST
	default y

if SOC_TYPE
choice
	prompt "SOC types"
	depends on MACH_XBURST
	default SOC_X1600

config SOC_X1000
	bool "x1000 socs"
	select INGENIC_INTC
	select CLK_X1000
	select CLKSRC_OF
	select PINCTRL
	select TIMER_OF
	select CLKDEV_LOOKUP
	select PINCTRL_INGENIC
	select CLKSRC_INGENIC_SYS_OST
	select MMU_NOTIFIER

config SOC_X1600
	bool "x1600 socs"
	select INGENIC_INTC
	select CLK_X1600
	select CLKSRC_OF
	select PINCTRL
	select TIMER_OF
	select CLKDEV_LOOKUP
	select PINCTRL_INGENIC
	select CLKSRC_INGENIC_SYS_OST
	select MMU_NOTIFIER
endchoice

config INGENIC_BUILTIN_DTB
	select BUILTIN_DTB
	depends on MACH_XBURST
	bool "Ingenic Device Tree build into Kernel."
	default y

source "arch/mips/xburst/soc-x1000/Kconfig.DT"
source "arch/mips/xburst/soc-x1600/Kconfig.DT"

config EXTAL_CLOCK
	depends on MACH_XBURST
	int "extal clock in MHz"
	default 24

config INGENIC_GPT_CHECK
	depends on MACH_XBURST
	bool "The physical space is larger than the virtual space"
	default y

config SUSPEND_TEST
	bool "auto suspend test"
	default n

config SUSPEND_ALARM_TIME
	int "suspend alarm time(second)"
	depends on SUSPEND_TEST
	default 2

config XBURST_MXUV2
	bool
	default n

endif
```

## arch/mips/xburst/soc-x1000/Kconfig.DT
```kconfig
choice
	prompt "device tree select for X1000 boards"
	default DT_X1000_MODULE
	depends on SOC_X1000

config DT_X1000_MODULE
	bool "x1000 module base"

endchoice
```

## arch/mips/xburst/soc-x1600/Kconfig.DT
```kconfig
choice
	prompt "device tree select for X1600 boards"
	default DT_HALLEY6_V10
	depends on SOC_X1600

config DT_X1600_MODULE
	bool "x1600 module base"

config DT_PANDA_V10
	bool "x1600 panda v10"

config DT_HALLEY6_V10
	bool "x1600 halley6 v10"

config DT_LX16
	bool "x1600 Letux X16"

endchoice
```

## arch/mips/xburst2/Kconfig
```kconfig
if MACH_XBURST2

menu "SOC Type Selection"
	depends on MACH_XBURST2


choice
	prompt "SOC types"
	depends on MACH_XBURST2
	default SOC_X2000

config SOC_X2000
	bool "x2000"
	select IRQ_INGENIC_CPU
	select CLK_X2000
	select INGENIC_INTC_CHIP
	select PINCTRL
	select PINCTRL_INGENIC_V2
	select TIMER_OF
	select CLKDEV_LOOKUP
	select CLKSRC_INGENIC_CORE_OST
	select MMU_NOTIFIER

config SOC_X2500
	bool "x2500"
	select IRQ_INGENIC_CPU
	select CLK_X2500
	select INGENIC_INTC_CHIP
	select PINCTRL
	select PINCTRL_INGENIC_V2
	select TIMER_OF
	select CLKDEV_LOOKUP
	select CLKSRC_INGENIC_CORE_OST
	select MMU_NOTIFIER

config SOC_M300
	bool "m300"
	select IRQ_INGENIC_CPU
	select CLK_M300
	select INGENIC_INTC_CHIP
	select PINCTRL
	select PINCTRL_INGENIC_V2
	select TIMER_OF
	select CLKDEV_LOOKUP
	select CLKSRC_INGENIC_CORE_OST
	select MMU_NOTIFIER

config SOC_X2100
	bool "x2100"
	select IRQ_INGENIC_CPU
	select CLK_X2100
	select INGENIC_INTC_CHIP
	select PINCTRL
	select PINCTRL_INGENIC_V2
	select TIMER_OF
	select CLKDEV_LOOKUP
	select CLKSRC_INGENIC_CORE_OST
	select MMU_NOTIFIER

endchoice

config INGENIC_BUILTIN_DTB
	select BUILTIN_DTB
	depends on MACH_XBURST2
	bool "Ingenic Device Tree build into Kernel."
	default y

source "arch/mips/xburst2/soc-x2000/Kconfig.DT"
source "arch/mips/xburst2/soc-x2500/Kconfig.DT"
source "arch/mips/xburst2/soc-m300/Kconfig.DT"


config RAW_BOOT
	bool "Raw Boot Kernel"
	select BOOT_RAW
	default n

config EXTAL_CLOCK
	depends on MACH_XBURST2
	int "extal clock in MHz"
	default 24

config FPGA_TEST
	depends on MACH_XBURST2
	bool "FPGA_TEST"
	default n

config INGENIC_GPT_CHECK
	depends on MACH_XBURST2
	bool "The physical space is larger than the virtual space"
	default y

config XBURST2_CPU_TEST
	depends on MACH_XBURST2
	bool "xburst2 cpu ddr test"
	default n


config FASTBOOT
	bool "FastBoot"
	depends on SOC_X2000 || SOC_M300 || SOC_X2100

endmenu

endif
```

## arch/mips/xburst2/soc-m300/Kconfig.DT
```kconfig
choice
	prompt "device tree select for m300 boards"
	depends on SOC_M300

config DT_GEWU_V10
	bool "m300 gewu v10"

config DT_M300_ZEBRA
	bool "m300 zebra"

endchoice
```

## arch/mips/xburst2/soc-x2000/Kconfig.DT
```kconfig
choice
	prompt "device tree select for X2000 X2100 boards"
	depends on SOC_X2000 || SOC_X2100

config DT_X2000_MODULE
       bool "x2000 module base"

config DT_HALLEY5_V20
       bool "x2000 halley5_v20"

config DT_HALLEY5_V30
       bool "x2000 halley5_v30"

config DT_KALE_V10
       bool "x2100 kale_v10"

endchoice
```

## arch/mips/xburst2/soc-x2500/Kconfig.DT
```kconfig
choice
	prompt "device tree select for X2500 boards"
	default DT_HIPPO_V10
	depends on SOC_X2500

config DT_GANDER_V10
	bool "x2500 gander_v10"
config DT_DARWIN_V14
	bool "x2500 darwin_v14"
config DT_HIPPO_V10
	bool "x2500 hippo_v10"
config DT_HIPPO_V12
	bool "x2500 hippo_v12"

endchoice
```

## drivers/dsp/syslink/Kconfig
```kconfig
menuconfig Sys_Link
	bool "Sys_Link"
	default y
if Sys_Link

config  SYSLINK_PROC
        tristate "Syslink ProcMgr"
        default y
	select OMAP_IOMMU
        help
           Syslink Proc manager

config  SYSLINK_PROC4430
        tristate "Proc 4430"
        depends on SYSLINK_PROC
        default y
        help
           Ducati Proc implementation

config  DUCATI_BASEIMAGE_PHYS_ADDR
	hex "Physical Address where the Ducati is loaded"
	depends on SYSLINK_PROC4430
	default 0x9CF00000
	help
	  Specify the physical address where the Ducati image will be
	  loaded.

config  SYSLINK_DUCATI_PM
        tristate "DUCATI POWER MANAGEMENT"
        depends on SYSLINK_PROC && SYSLINK_PROC4430
        default y
        help
           Ducati Power Management Implementation

config MPU_SYSLINK_PLATFORM
        tristate "Syslink Platform Module"
        default y
        help
          Syslink Platform Module

config MPU_SYSLINK_IPC
        tristate "Syslink IPC Module"
        depends on SYSLINK_PROC4430
        default y
        select OMAP_MBOX_FWK
        select OMAP_REMOTE_PROC
        help
          Syslink IPC Module (includes Notify)

config SYSLINK_USE_SYSMGR
        bool "Enable SYS MGR setup"
        depends on MPU_SYSLINK_IPC && SYSLINK_PROC
        default y
        help
          This is the experimental option to enable SYS manager setup

config OMAP_IOMMU_DEBUG_MODULE
	bool "IOMMU debugging"
	depends on OMAP_IOMMU
	default y
endif
```

## drivers/gpu/drm/omapdrm/displays/Kconfig
```kconfig
# SPDX-License-Identifier: GPL-2.0-only
menu "OMAPDRM External Display Device Drivers"

config DRM_OMAP_PANEL_DSI_CM
	tristate "Generic DSI Command Mode Panel"
	depends on BACKLIGHT_CLASS_DEVICE
	help
	  Driver for generic DSI command mode panels.

config DRM_OMAP_PANEL_BOE_W677L
	tristate "BOE W677L LCD Panel"
	help
		This is for OTM1283A based panels.
		* BOE W677L used in the Pyra.

endmenu
```

## drivers/media/video/omap/Kconfig
```kconfig
config VIDEO_OMAP3_OUT
	tristate "OMAP2/OMAP3/OMAP4 V4L2-DSS driver"
	select VIDEOBUF_GEN
	select VIDEOBUF_DMA_SG
	select OMAP2_DSS
	depends on VIDEO_DEV && (ARCH_OMAP24XX || ARCH_OMAP34XX || ARCH_OMAP4)
	default y
	---help---
        V4L2 DSS support for OMAP2/3/4 based boards.
```

## drivers/misc/esp_hosted_ng/Kconfig
```kconfig
config ESP_HOSTED_NG
	tristate "TI TWL4030 Audio"
	default n
	help
	  This is the ESP hosted ng driver.

choice
	prompt "Interface"
	default ESP_HOSTED_NG_SDIO

config ESP_HOSTED_NG_SDIO
	bool "sdio"

config ESP_HOSTED_NG_SPI
	bool "spi"

endchoice
```

## drivers/misc/retrode3/Kconfig
```kconfig
# SPDX-License-Identifier: GPL-2.0-only
#
# Retrode3
#

config RETRODE3_BUS
	tristate "Retrode3 GPIO based Bus controller"
	help
	  Choose Y or M.

config RETRODE3_BUFFER
	bool "use in-kernel driver buffer to speed up read()"
	depends on RETRODE3_BUS
	help
	  Choose N or Y.

config RETRODE3_MEGADRIVE
	tristate "Retrode3 driver for MegaDrive slot"
	depends on RETRODE3_BUS
	help
	  Choose Y or M.

config RETRODE3_NES
	tristate "Retrode3 driver for NES slot"
	depends on RETRODE3_BUS
	help
	  Choose Y or M.

config RETRODE3_SNES
	tristate "Retrode3 driver for SNES slot"
	depends on RETRODE3_BUS
	help
	  Choose Y or M.

config RETRODE3_CONTROLLER
	tristate "Retrode3 driver for Game Controllers"
	depends on RETRODE3_BUS
	help
	  Choose Y or M.
```

## drivers/misc/ti-ec/Kconfig
```kconfig
config EARLYCAMERA_MPU
	tristate "Early Camera Driver"
	default n
	help
           Early Camera Driver.
```

## drivers/mmc/Kconfig
```kconfig
#
# MMC subsystem configuration
#

menuconfig MMC
	tristate "MMC/SD/SDIO card support"
	depends on HAS_IOMEM
	help
	  This selects MultiMediaCard, Secure Digital and Secure
	  Digital I/O support.

	  If you want MMC/SD/SDIO support, you should say Y here and
	  also to your specific host controller driver.

if MMC

source "drivers/mmc/core/Kconfig"

source "drivers/mmc/host/Kconfig"

config TXS02612
	tristate "SD/MMC switch and level shifter"
	depends on GPIOLIB
	help
	  If you say yes here you can use the txs02612 sd switch
	  and level shifter.
	  The driver is intended to finally provide transparent
	  use of both SD cards connected to a single host SD interface
	  but currently there is only a sysfs control to throw the
	  switch. Please eject the "drive" before toggling the switch.

endif # MMC
```

## drivers/net/wireless/espressif/esp_hosted_ng/Kconfig
```kconfig
# SPDX-License-Identifier: GPL-2.0
# based on drivers / net / wireless / microchip / wilc1000 / Kconfig
# description needs to be fixed

config ESP_HOSTED_NG
	tristate
	help
	  Add support for the Espressif 802.11 b/g/n SoC.
	  This provides Wi-FI over an SDIO or SPI interface, and
	  is usually found in IoT devices.

	  This module only support IEEE 802.11n WiFi.

config ESP_HOSTED_NG_SDIO
	tristate "Espressif SDIO"
	depends on CFG80211 && INET && MMC && !CONFIG_BT_HCIBTSDIO
	select ESP_HOSTED_NG
	help
	  This module adds support for the SDIO interface of adapters using
	  ESP32 chipset. The ESP32 SDIO is a full speed interface.
	  It meets SDIO card specification version 2.0. The interface supports
	  the 1-bit/4-bit SD transfer mode at the clock range of 0-50 MHz.
	  The host can use this interface to read and write from any register
	  within the chip as well as configure the ESP32 for data DMA.
	  Select this if your platform is using the SDIO bus.

config ESP_HOSTED_NG_SPI
	tristate "Espressif SPI"
	depends on CFG80211 && INET && SPI
	select ESP_HOSTED_NG
	select CRC7
	select CRC_ITU_T
	help
	  This module adds support for the SPI interface of adapters using
	  ESP32 chipset. The ESP32 SDIO has a Serial Peripheral
	  Interface (SPI) that operates as a SPI slave. This SPI interface can
	  be used for control and for serial I/O of 802.11 data.
	  Select this if your platform is using the SPI bus.

config ENABLE_MONITOR_PROCESS
	depends on ESP_HOSTED_NG
	bool "Enable monitor process for Espressif devices"
```

## drivers/power/Kconfig
```kconfig
source "drivers/power/avs/Kconfig"
source "drivers/power/reset/Kconfig"
source "drivers/power/supply/Kconfig"

config CONFIG_POWER_MIPSBOOK_400
	tristate "MIPSbook 400 power controller support"
	depends on I2C
	help
	  This adds support for the Mipsbook (like Letux 400). It provides
	  battery status and system power off.
```

## drivers/power/coproc/Kconfig
```kconfig
config TI_COPROC
	tristate "TI Co-processor driversupport"
	depends on VOLTAGE_DOMAIN_OMAP
	help
		TI Coprocessor driver helps initialize a coprocessor to
		a particular Operating performance point.
```

## drivers/sdio/Kconfig
```kconfig
#
# SDIO driver and host controller support
#

menu "SDIO support"

config SDIO
        tristate "SDIO support"
        default m
        ---help---
          good luck.

source "drivers/sdio/hcd/Kconfig"

source "drivers/sdio/function/Kconfig"

endmenu
```

## drivers/sdio/function/Kconfig
```kconfig
#menu "SDIO function drivers"

config SDIO_AR6000_WLAN
        tristate "ar6000 wireless networking over sdio"
	depends on SDIO
        select WIRELESS_EXT
        default m
        help
          good luck.

#endmenu
```
