## module_drivers/drivers/clk/ingenic-v2/Kconfig
```kconfig
config COMMON_CLK_INGENIC
	bool
	depends on MACH_XBURST || MACH_XBURST2
	select MFD_SYSCON
	select INGENIC_CLK_DEBUG_FS

config INGENIC_CLK_DEBUG_FS
	bool
	depends on DEBUG_FS
	help
	  enable ingenic common clock debugfs


config CLK_X2000
	bool "clk x2000"
	depends on SOC_X2000
	select COMMON_CLK_INGENIC
	help
	  build the ingenic x2000 soc clock driver.

config CLK_X2100
	bool "clk x2100"
	depends on SOC_X2100
	select COMMON_CLK_INGENIC
	help
	  build the ingenic x2000-v12 soc clock driver.

config CLK_M300
	bool "clk m300"
	depends on SOC_M300
	select COMMON_CLK_INGENIC
	help
	  build the ingenic m300 soc clock driver.


config CLK_X2500
	bool "clk x2500"
	depends on SOC_X2500
	select COMMON_CLK_INGENIC
	help
	  build the ingenic x2500 soc clock driver.

config CLK_X1600
	bool "clk x1600"
	depends on SOC_X1600
	select COMMON_CLK_INGENIC
	help
	  build the ingenic x1600 soc clock driver.
```

## module_drivers/drivers/clocksource/Kconfig
```kconfig
config CLKSRC_INGENIC_SYS_OST
        bool "OST clocksource."
        select CLKSRC_OF
	depends on SOC_X1600
	help
	    sys ost for ingenic xburst base socs.

config CLKSRC_INGENIC_CORE_OST
        bool "Core OST clocksource."
        select CLKSRC_OF
	depends on SOC_X2000 || SOC_X2000_V12 || SOC_M300 || SOC_X2100 || SOC_X2500
        help
          core sys ost for ingenic xburst2 based SOCs. each cpu has
          an ost and all cpu shares a global clocksource.
```

## module_drivers/drivers/crypto/Kconfig
```kconfig
config CRYPTO_DEV_INGENIC_SHA
        tristate "[SHA] Support for Ingenic SHA hw accelerator"
        depends on MACH_XBURST || MACH_XBURST2
        select CRYPTO_ALGAPI
        help
          Some Ingenic processors have MD5/SHA1/SHA224/SHA256/SHA384/SHA512
          hw accelerator.
          Select this if you want to use the Ingenic module for
          MD5/SHA1/SHA224/SHA256/SHA384/SHA512 algorithms.

          To compile this driver as a module, choose M here: the module
          will be called ingenic-sha.


config CRYPTO_DEV_INGENIC_AES
        tristate "[AES] Support for INGENIC AES hw engine"
        depends on MACH_XBURST || MACH_XBURST2
        select CRYPTO_AES
        select CRYPTO_BLKCIPHER2
        help
          INGENIC processors have AES module accelerator. Select this if you
          want to use the INGENIC module for AES algorithms.
```

## module_drivers/drivers/dma/ingenic/Kconfig
```kconfig
config INGENIC_PDMAC
        bool "Ingenic programmable dma controller (Of Driver)"
        depends on MACH_XBURST || MACH_XBURST2
        select DMA_VIRTUAL_CHANNELS
        select DMA_ENGINE
        help
          This selects support for the DMA controller in Ingenic X1000 M200 SoCs.
          If you have a board based on such a SoC and wish to use DMA for
          devices which can use the DMA controller, say Y or M here.



# DMA engine configuration for ingenic
config INGENIC_DMA_RECEIVE_DXTERNAL_DECIDE
	tristate "ingenic dma receiving data is externally determined"
	depends on INGENIC_PDMAC && SOC_X1600
	default n
	help
	How much data is received is externally determined

config INGENIC_AIC_USES_PDMA
	bool "Ingenic AIC use pdma as dma."
	depends on INGENIC_PDMAC
	default n
```

## module_drivers/drivers/i2c/busses/Kconfig
```kconfig
config I2C_INGENIC
        bool "Ingenic SoC based on Xburst arch's I2C controler Driver support"
        help
          Say Y here in order to support Ingenic SoC's I2C Controller Drvier

config I2C_NON_RESTART_MODE
        bool "controler i2c no restart mode"
        depends on I2C_INGENIC
        default n

config I2C_FIFO_LEN
        int "INGENIC I2C Controller FIFO length"
        default 64
        depends on I2C_INGENIC
        help
          M200 and JZ4775 have 64 entries FIFO.

config I2C_DEBUG_INFO
        bool "enable or disable Ingenic Soc's I2C driver debug info"
        default n
        depends on I2C_INGENIC
        help
          I2C debug print info, you can get the debug information from
          /sys/devices/platform/i2c-ingenic.x/debug_info,
          for example, echo 3 > /sys/devices/platform/i2c-ingenic.x/debug
```

## module_drivers/drivers/input/touchscreen/Kconfig
```kconfig
#source "module_drivers/drivers/input/touchscreen/cyttsp5/Kconfig"
source "module_drivers/drivers/input/touchscreen/focaltech_touch/Kconfig"
#source "module_drivers/drivers/input/touchscreen/focaltech_ft5x16_touch/Kconfig"
source "module_drivers/drivers/input/touchscreen/hyn_touch/Kconfig"
#source "module_drivers/drivers/input/touchscreen/chipone_touch/Kconfig"
#source "module_drivers/drivers/input/touchscreen/msm8909w/Kconfig"
source "module_drivers/drivers/input/touchscreen/gt9xx_touch/Kconfig"
source "module_drivers/drivers/input/touchscreen/ft6236_touch/Kconfig"


config TOUCHSCREEN_MXT336U
      tristate "MicroChip MXT336U TouchScreen driver"
      depends on I2C
      default n
      help
        MicroChip MXT336U TouchScreen driver implemented by Ingenic for Robam.
```

## module_drivers/drivers/input/touchscreen/ft6236_touch/Kconfig
```kconfig
#
# Focaltech Touchscreen driver configuration
#

config TOUCHSCREEN_FT6236
    bool "FT6236 Touchscreen"
    default n
    help
      Say Y here if you have Focaltech touch panel.
      If unsure, say N.
```

## module_drivers/drivers/input/touchscreen/gt9xx_touch/Kconfig
```kconfig
#
# Focaltech Touchscreen driver configuration
#

config TOUCHSCREEN_GT9XX
    bool "GT9XX Touchscreen"
    default n
    help
      Say Y here if you have Focaltech touch panel.
      If unsure, say N.

config TOUCHSCREEN_GT9XX_DIRECTORY
    string "gt ts directory name"
    default "gt9xx_touch"
    depends on TOUCHSCREEN_GT9XX
```

## module_drivers/drivers/input/touchscreen/hyn_touch/Kconfig
```kconfig
#
# Focaltech Touchscreen driver configuration
#

config TOUCHSCREEN_HYN
    bool "hyn Touchscreen"
    default n
    help
      Say Y here if you have Focaltech touch panel.
      If unsure, say N.

config TOUCHSCREEN_HYN_DIRECTORY
    string "hyn ts directory name"
    default "hyn_touch"
    depends on TOUCHSCREEN_HYN
```

## module_drivers/drivers/irqchip/Kconfig
```kconfig
config INGENIC_INTC
        bool "intc v1 interrupt "
	depends on SOC_X1600
        select IRQ_DOMAIN

config IRQ_INGENIC_CPU
        bool "cpu interrupt driver"
	depends on SOC_X2000 || SOC_X2000_V12 || SOC_X2100 || SOC_X2500 || SOC_M300
        select IRQ_DOMAIN
        help
                Support for ingenic cpu core irq handler.

config INGENIC_INTC_CHIP
        bool "intc v2 interrupt driver"
        depends on IRQ_INGENIC_CPU
        select IRQ_DOMAIN
        help
                Support for ingenic XBURST2 based SOCs, which intc is
                near cpu core,and each logic cpu has an intc.
```
