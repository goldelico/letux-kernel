## drivers/sdio/hcd/Kconfig
```kconfig
config SDIO_S3C24XX
	tristate "Samsung s3c24xx host controller"
	depends on PLAT_S3C24XX && SDIO
	default m
	help
	  good luck.

config SDIO_S3C24XX_DMA
	bool "Samsung s3c24xx host controller DMA I/O"
	depends on SDIO_S3C24XX
	default n
	help
	  good luck.
```

## drivers/security/smc/Kconfig
```kconfig
menu "SMC Driver Support for OMAP3"
	depends on ARCH_OMAP3
config  SMC_DRIVER
	bool "SMC Driver for OMAP3"
	default n
	help
	  This option selects SMC driver for OMAP3XXX EMU/HS Devices.

config SMC_DRIVER_DEBUG_SUPPORT
	depends on SMC_DRIVER
	bool "Debug Support"
	default n
	help
	  This option selects the debug support
endmenu
```

## drivers/staging/android/Kconfig
```kconfig
# SPDX-License-Identifier: GPL-2.0
menu "Android"

if ANDROID

config ANDROID_VSOC
	tristate "Android Virtual SoC support"
	depends on PCI_MSI
	help
	  This option adds support for the Virtual SoC driver needed to boot
	  a 'cuttlefish' Android image inside QEmu. The driver interacts with
	  a QEmu ivshmem device. If built as a module, it will be called vsoc.

config ANDROID_LOGGER
	tristate "Android log driver"
	default n
	---help---
	  This adds support for system-wide logging using four log buffers.

	  These are:

	      1: main
	      2: events
	      3: radio
	      4: system

	  Log reading and writing is performed via normal Linux reads and
	  optimized writes. This optimization avoids logging having too
	  much overhead in the system.

config ANDROID_TIMED_OUTPUT
	bool "Timed output class driver"
	default y

config ANDROID_TIMED_GPIO
	tristate "Android timed gpio driver"
	depends on GPIOLIB || COMPILE_TEST
	depends on ANDROID_TIMED_OUTPUT
	default n
        ---help---
	  Unlike generic gpio is to allow programs to access and manipulate gpio
	  registers from user space, timed output/gpio is a system to allow changing
	  a gpio pin and restore it automatically after a specified timeout.

config ANDROID_LOW_MEMORY_KILLER
	bool "Android Low Memory Killer"
	---help---
	  Registers processes to be killed when low memory conditions, this is useful
	  as there is no particular swap space on android.

	  The registered process will kill according to the priorities in android init
	  scripts (/init.rc), and it defines priority values with minimum free memory size
	  for each priority.

config ANDROID_INTF_ALARM_DEV
	tristate "Android alarm driver"
	depends on RTC_CLASS
	default n
	---help---
	  Provides non-wakeup and rtc backed wakeup alarms based on rtc or
	  elapsed realtime, and a non-wakeup alarm on the monotonic clock.
	  Also exports the alarm interface to user-space.

config ASHMEM
	bool "Enable the Anonymous Shared Memory Subsystem"
	depends on SHMEM
	help
	  The ashmem subsystem is a new shared memory allocator, similar to
	  POSIX SHM but with different behavior and sporting a simpler
	  file-based API.

	  It is, in theory, a good memory allocator for low-memory devices,
	  because it can discard shared memory units when under memory pressure.

endif # if ANDROID

endmenu
```

## drivers/staging/iio/gyro/Kconfig
```kconfig
#
# IIO Digital Gyroscope Sensor drivers configuration
#
menu "Digital gyroscope sensors"

config ADIS16060
	tristate "Analog Devices ADIS16060 Yaw Rate Gyroscope with SPI driver"
	depends on SPI
	help
	  Say yes here to build support for Analog Devices adis16060 wide bandwidth
	  yaw rate gyroscope with SPI.

config ITG3200
	tristate "InvenSence ITG3200 3-axis gyroscope"
	depends on I2C
	help
	  Support for 3-axis gyroscope as IIO device

config ITG3200
	tristate "InvenSence ITG3200 3-axis gyroscope"
	depends on I2C
	help
	  Support for 3-axis gyroscope as IIO device

endmenu
```

## drivers/staging/pvr/Kconfig
```kconfig
config SGX
	bool "PowerVR SGX"
	---help---
	  Support for the PowerVR SGX 3D core.

config SGX_DEBUG
	bool "PowerVR SGX build with DEBUG enabled"
	depends on SGX
	---help---
	  Build for DEBUG.

config SGX_DRM
	bool "PowerVR SGX build with DRM support"
	depends on SGX
	---help---
	  Build for using DRM infrastructure.

config SGX_OMAP
	tristate "PowerVR SGX inside OMAP SoC"
	depends on SGX  && (ARCH_OMAP3 || ARCH_OMAP4 || ARCH_OMAP5)
	---help---
	  Support for the PowerVR SGX 3D core inside OMAP SoC.
```

## drivers/staging/thermal_framework/governor/Kconfig
```kconfig
#
# Thermal governor driver config
#

config OMAP_DIE_GOVERNOR
	bool "OMAP On Die thermal governor support"
	depends on THERMAL_FRAMEWORK && OMAP_THERMAL
	help
	  This is the governor for the OMAP4 On-Die temperature sensor.
	  This governer will institute the policy to call specific
	  cooling agents.

config OMAP_GPU_GOVERNOR
	bool "OMAP GPU thermal governor support"
	depends on THERMAL_FRAMEWORK && OMAP_THERMAL
	help
	  This is the governor for the OMAP4+ GPU temperature sensor.
	  This governer will institute the policy to call specific
	  cooling agents.

config CASE_TEMP_GOVERNOR
	bool "Case thermal governor support"
	depends on THERMAL_FRAMEWORK && OMAP_THERMAL
	help
	  This is the governor for the Case temperature sensor.
	  This governer will institute the policy to call specific
	  cooling agents.
```

## drivers/staging/thermal_framework/sensor/Kconfig
```kconfig
#
# Thermal Temp sensor configuration
#

config CASE_TEMP_SENSOR
	bool "Case temp sensor support"
	depends on THERMAL_FRAMEWORK && OMAP_THERMAL
	help
	  Enabling this config will give support for the case
	  temp sensor for the OMAP platform.

config OMAP_TMP102_SENSOR
	bool "OMAP TMP102 temp sensor support"
	depends on THERMAL_FRAMEWORK
	help
	  Enabling this config will give support for the tmp102
	  temp sensor for the OMAP platform.
```

## drivers/tty/slave/Kconfig
```kconfig
menuconfig TTY_SLAVE
	tristate "TTY slave devices"
	depends on OF
	help
	  Devices which attach via a uart, but need extra
	  driver support for power management etc.

if TTY_SLAVE

config SERIAL_POWER_MANAGER
	tristate "Power Management controller for serial-attached devices"
	default n
	help
	  Some devices permanently attached via a UART can benefit from
	  being power-managed when the tty device is opened or closed.
	  This driver can support several such devices with simple
	  power requirements such as enabling a regulator.

	  If in doubt, say 'N'

endif
```

## drivers/video/display/Kconfig
```kconfig
#
# Display drivers configuration
#

menu "Display device support"

config DISPLAY_SUPPORT
	tristate "Display panel/monitor support"
	---help---
	  This framework adds support for low-level control of a display.
	  This includes support for power.

	  Enable this to be able to choose the drivers for controlling the
	  physical display panel/monitor on some platforms. This not only
	  covers LCD displays for PDAs but also other types of displays
	  such as CRT, TVout etc.

	  To have support for your specific display panel you will have to
	  select the proper drivers which depend on this option.

comment "Display hardware drivers"
	depends on DISPLAY_SUPPORT

config DISPLAY_JBT6K74
	tristate "TPO JBT6K74-AS TFT display ASIC control interface"
	depends on SPI_MASTER && SYSFS
	help
	  SPI driver for the control interface of TFT panels containing
	  the TPO JBT6K74-AS controller ASIC, such as the TPO TD028TTEC1
	  TFT diplay module used in the FIC/Openmoko Neo1973 GSM phones.

	  The control interface is required for display operation, as it
	  controls power management, display timing and gamma calibration.

config DISPLAY_L1K002
	tristate "TP0 L1K0-02 TFT ASIC control interface"
	depends on SPI_MASTER && SYSFS
	help
	  The control interface of this LTPS TFT panel is based on SPI bitbang driver.
	  It controls display timing and gamma calibration. TP0 LPJ028T007A LCM uses this IC
	  as its controller in the Openmoko GTA03 GSM phone.

endmenu
```

## drivers/video/omap2/dss/Kconfig
```kconfig
menuconfig OMAP2_DSS
        tristate "OMAP2/3 Display Subsystem support (EXPERIMENTAL)"
        depends on ARCH_OMAP2 || ARCH_OMAP3 || ARCH_OMAP4
        default y
	help
          OMAP2/3/4 Display Subsystem support.

if OMAP2_DSS

config OMAP2_VRAM_SIZE
	int "VRAM size (MB)"
	range 0 32
	default 0
	help
	  The amount of SDRAM to reserve at boot time for video RAM use.
	  This VRAM will be used by omapfb and other drivers that need
	  large continuous RAM area for video use.

	  You can also set this with "vram=<bytes>" kernel argument, or
	  in the board file.

config OMAP2_DSS_DEBUG_SUPPORT
        bool "Debug support"
	default y
	help
	  This enables debug messages. You need to enable printing
	  with 'debug' module parameter.

config OMAP2_DSS_RFBI
	bool "RFBI support"
        default n
	help
	  MIPI DBI, or RFBI (Remote Framebuffer Interface), support.

config OMAP2_DSS_VENC
	bool "VENC support"
        default y
	help
	  OMAP Video Encoder support.

config OMAP2_DSS_HDMI
	bool "HDMI support"
        default n
	help
	  OMAP HDMI panel support.

config OMAP2_DSS_SDI
	bool "SDI support"
	depends on ARCH_OMAP3
        default n
	help
	  SDI (Serial Display Interface) support.

config OMAP2_DSS_DSI
	bool "DSI support"
	depends on ARCH_OMAP3 || ARCH_OMAP4
        default n
	help
	  MIPI DSI support.

config OMAP2_DSS_FAKE_VSYNC
	bool "Fake VSYNC irq from manual update displays"
	default n
	help
	  If this is selected, DSI will generate a fake DISPC VSYNC interrupt
	  when DSI has sent a frame. This is only needed with DSI or RFBI
	  displays using manual mode, and you want VSYNC to, for example,
	  time animation.

config OMAP2_DSS_MIN_FCK_PER_PCK
	int "Minimum FCK/PCK ratio (for scaling)"
	range 0 32
	default 0
	help
	  This can be used to adjust the minimum FCK/PCK ratio.

	  With this you can make sure that DISPC FCK is at least
	  n x PCK. Video plane scaling requires higher FCK than
	  normally.

	  If this is set to 0, there's no extra constraint on the
	  DISPC FCK. However, the FCK will at minimum be
	  2xPCK (if active matrix) or 3xPCK (if passive matrix).

	  Max FCK is 173MHz, so this doesn't work if your PCK
	  is very high.

endif
```

## drivers/video/serdes/Kconfig
```kconfig
menu "Video Serializer Deserializer drivers"

config VIDEO_TI_FPD3_SERDES
	tristate "Texas Instruments FPD link 3 serializer deserializer"
	depends on I2C
	help
		This driver is used for configuring video serializers and
		deserializers. When capturing video from a remote camera or
		displaying to a remote display, the camera or display is
		connected via FPDlink serializer / deserializer.

endmenu
```

## fs/ubifs/Kconfig
```kconfig
config UBIFS_FS
	tristate "UBIFS file system support"
	select CRC16
	select CRC32
	depends on MTD_UBI
	help
	  UBIFS is a file system for flash devices which works on top of UBI.

config UBIFS_FS_XATTR
	bool "Extended attributes support"
	depends on UBIFS_FS
	default n
	help
	  This option enables support of extended attributes.

config UBIFS_FS_ADVANCED_COMPR
	bool "Advanced compression options"
	depends on UBIFS_FS
	default n
	help
	  This option allows to explicitly choose which compressions, if any,
	  are enabled in UBIFS. Removing compressors means inbility to read
	  existing file systems.

	  If unsure, say 'N'.

config UBIFS_FS_LZO
	bool "LZO compression support" if UBIFS_FS_ADVANCED_COMPR
	select CRYPTO
	select CRYPTO_LZO
	depends on UBIFS_FS
	default y
	help
	   LZO compressor is generally faster then zlib but compresses worse.
	   Say 'Y' if unsure.

config UBIFS_FS_ZLIB
	bool "ZLIB compression support" if UBIFS_FS_ADVANCED_COMPR
	select CRYPTO
	select CRYPTO_DEFLATE
	depends on UBIFS_FS
	default y
	help
	  Zlib copresses better then LZO but it is slower. Say 'Y' if unsure.

# Debugging-related stuff
source "fs/ubifs/Kconfig.debug"
```

## module_drivers/Kconfig
```kconfig
menu "Ingenic device-drivers Configurations"


config OUTSIDE_DRIVERS_PATH
	string
	default "module_drivers"

source "module_drivers/drivers/Kconfig"
source "module_drivers/sound/soc/ingenic/Kconfig"

endmenu
```

## module_drivers/drivers/Kconfig
```kconfig
comment "---- Minimal required Drivers ----"
menu "[Interrupt] Drivers"
source "module_drivers/drivers/irqchip/Kconfig"
endmenu

menu "[OST] clocksoure Drivers"
source "module_drivers/drivers/clocksource/Kconfig"
endmenu

menu "[CPM] clk Drivers"
source "module_drivers/drivers/clk/ingenic-v2/Kconfig"
endmenu

menu "[GPIO] Pinctroller Drivers"
source "module_drivers/drivers/pinctrl/Kconfig"
endmenu

menu "[UART] Drivers"
source "module_drivers/drivers/tty/serial/Kconfig"
endmenu

menu "[MSC] (eMMC/SD/SDIO) and Device Drivers"
source "module_drivers/drivers/mmc/host/Kconfig"
endmenu

menu "[DMA] Drivers"
source "module_drivers/drivers/dma/ingenic/Kconfig"
endmenu

menu "[SFC] (SPI Nand/Nor Flash) Drivers"
source "module_drivers/drivers/mtd/devices/Kconfig"
endmenu

menu "[SPI] Master/Slave Drivers"
source "module_drivers/drivers/spi/Kconfig"
endmenu

menu "[I2C] Master Drivers"
source "module_drivers/drivers/i2c/busses/Kconfig"
endmenu

comment "---- minimal OS requirements. ----"

menu "[LCD] Panel/Touchscreen Drivers"

source "module_drivers/drivers/video/fbdev/ingenic/Kconfig"
source "module_drivers/drivers/video/logo-ingenic/Kconfig"

menu "Touchscreen Drivers"
source "module_drivers/drivers/input/touchscreen/Kconfig"
endmenu
endmenu



menu "[GMAC] (ethernet) Drivers"
source "module_drivers/drivers/net/ethernet/ingenic/Kconfig"
endmenu
menu "[WIFI]  Drivers"
source "module_drivers/drivers/net/wireless/bcmdhd_1_363_125_17/Kconfig"
source "module_drivers/drivers/net/wireless/bcmdhd/Kconfig"
endmenu

menu "[CAN] (ethernet) Drivers"
#source "module_drivers/drivers/net/can/ingenic/Kconfig"
endmenu

comment "---- (V4L2) Media Device Drivers ----"
source "module_drivers/drivers/media/v4l2-core/Kconfig"
source "module_drivers/drivers/media/platform/Kconfig"
menu "[Sensors] Camera Sensors"
source "module_drivers/drivers/media/i2c/Kconfig"
endmenu

source "module_drivers/drivers/video/ingenic_bscaler/Kconfig"
source "module_drivers/drivers/video/ingenic-nna/Kconfig"
source "module_drivers/drivers/video/ingenic_ipu/Kconfig"
source "module_drivers/drivers/video/ingenic_avpu/Kconfig"



comment "---- MISC Device Drivers ----"
source "module_drivers/drivers/misc/Kconfig"

menu "[RANDOM] drivers"
source "module_drivers/drivers/char/hw_random/Kconfig"
endmenu

comment "[MFD] Multi Function Device Drivers"
source "module_drivers/drivers/mfd/Kconfig"

comment "[Power] power and regulator Drivers"
#source "module_drivers/drivers/power/Kconfig"
#source "module_drivers/drivers/regulator/Kconfig"

source "module_drivers/drivers/crypto/Kconfig"


menu "[WDT] watchdog Drivers"
source "module_drivers/drivers/watchdog/Kconfig"
endmenu


menu "[PWM] drivers"
source "module_drivers/drivers/pwm/Kconfig"
endmenu

menu "[RTC] drivers"
source "module_drivers/drivers/rtc/Kconfig"
endmenu
```

## module_drivers/drivers/char/hw_random/Kconfig
```kconfig
config HW_RANDOM_INGENIC
        tristate "[RANDOM] Ingenic HW Random Number Generator support"
        depends on MIPS
        help
         This driver provides kernel-side support for the Random Number
         Generator hardware found on Ingenic processors.

         To compile this driver as a module, choose M here: the
         module will be called ingenic-rng.

         If unsure, say N.
```
