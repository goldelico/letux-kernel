## Documentation/devicetree/bindings/leds/backlight/pwm-backlight.yaml
```yaml
# SPDX-License-Identifier: GPL-2.0-only
%YAML 1.2
---
$id: http://devicetree.org/schemas/leds/backlight/pwm-backlight.yaml#
$schema: http://devicetree.org/meta-schemas/core.yaml#

title: pwm-backlight

maintainers:
  - Lee Jones <lee@kernel.org>
  - Daniel Thompson <daniel.thompson@linaro.org>
  - Jingoo Han <jingoohan1@gmail.com>

allOf:
  - $ref: common.yaml#

properties:
  compatible:
    const: pwm-backlight

  pwms:
    maxItems: 1

  pwm-names: true

  power-supply:
    description: regulator for supply voltage

  enable-gpios:
    description:
      Contains a single GPIO specifier for the GPIO which enables and disables
      the backlight.
    maxItems: 1

  post-pwm-on-delay-ms:
    description:
      Delay in ms between setting an initial (non-zero) PWM and enabling the
      backlight using GPIO.

  pwm-off-delay-ms:
    description:
      Delay in ms between disabling the backlight using GPIO and setting PWM
      value to 0.

  num-interpolated-steps:
    description:
      Number of interpolated steps between each value of brightness-levels
      table. This way a high resolution pwm duty cycle can be used without
      having to list out every possible value in the brightness-level array.
    $ref: /schemas/types.yaml#/definitions/uint32

  pwm-enable-guard-period-us:
    description: >
      Duration in microseconds for which the PWM consumer requests
      full duty (duty_cycle == period) before applying the requested
      brightness. The guard is issued if the previous PWM state was
      disabled or had zero duty cycle, e.g. after power-up or resume.

      This can allow LED drivers with startup mode detection to settle
      before normal PWM dimming begins. For example, TI TPS61160/61
      distinguish PWM dimming from EasyScale by the duration of low
      intervals on CTRL during an initial detection window. The guard
      duration must cover that window according to the LED driver
      datasheet.

      The PWM provider may approximate full duty if the hardware
      cannot represent it exactly. The board must ensure that the
      resulting waveform meets the LED driver startup requirements
      and that the input has a defined inactive state while off.
    default: 0

dependencies:
  default-brightness-level: [brightness-levels]
  num-interpolated-steps: [brightness-levels]

required:
  - compatible
  - pwms

unevaluatedProperties: false

examples:
  - |
    backlight {
        compatible = "pwm-backlight";
        pwms = <&pwm 0 5000000>;

        brightness-levels = <0 4 8 16 32 64 128 255>;
        default-brightness-level = <6>;

        power-supply = <&vdd_bl_reg>;
        enable-gpios = <&gpio 58 0>;
        post-pwm-on-delay-ms = <10>;
        pwm-off-delay-ms = <10>;
    };

  - |
    // Example using num-interpolation-steps:
    backlight {
        compatible = "pwm-backlight";
        pwms = <&pwm 0 5000000>;

        brightness-levels = <0 2048 4096 8192 16384 65535>;
        num-interpolated-steps = <2048>;
        default-brightness-level = <4096>;

        power-supply = <&vdd_bl_reg>;
        enable-gpios = <&gpio 58 0>;
    };

...
```

## Documentation/devicetree/bindings/pwm/ingenic,x1600-pwm.yaml
```yaml
# SPDX-License-Identifier: (GPL-2.0-only OR BSD-2-Clause)
%YAML 1.2
---
$id: http://devicetree.org/schemas/pwm/ingenic,x1600-pwm.yaml#
$schema: http://devicetree.org/meta-schemas/core.yaml#

title: Ingenic X1600 PWM controller

maintainers:
  - Olivier Louvignes <olivier@mgcrea.io>

description:
  The eight-channel PWM controller of the Ingenic X1600 SoC, separate from
  the TCU timers that drive the PWMs of earlier Ingenic SoCs.

allOf:
  - $ref: pwm.yaml#

properties:
  compatible:
    const: ingenic,x1600-pwm

  reg:
    maxItems: 1

  clocks:
    maxItems: 1

  "#pwm-cells":
    const: 3

required:
  - compatible
  - reg
  - clocks
  - "#pwm-cells"

unevaluatedProperties: false

examples:
  - |
    pwm@134c0000 {
        compatible = "ingenic,x1600-pwm";
        reg = <0x134c0000 0x200>;
        clocks = <&cgu 21>;
        #pwm-cells = <3>;
    };
```

## Documentation/devicetree/bindings/spi/ingenic,sfc.yaml
```yaml
# SPDX-License-Identifier: (GPL-2.0-only OR BSD-2-Clause)
%YAML 1.2
---
$id: http://devicetree.org/schemas/spi/ingenic,sfc.yaml#
$schema: http://devicetree.org/meta-schemas/core.yaml#

title: Ingenic SoCs SPI flash controller

maintainers:
  - Olivier Louvignes <olivier@mgcrea.io>

allOf:
  - $ref: /schemas/spi/spi-controller.yaml#

properties:
  compatible:
    enum:
      - ingenic,x1600-sfc

  reg:
    maxItems: 1

  interrupts:
    maxItems: 1

  clocks:
    maxItems: 1

required:
  - compatible
  - reg
  - clocks

unevaluatedProperties: false

examples:
  - |
    #include <dt-bindings/clock/ingenic,x1600-cgu.h>

    spi@13440000 {
        compatible = "ingenic,x1600-sfc";
        reg = <0x13440000 0x10000>;
        interrupts = <7>;
        clocks = <&cgu X1600_CLK_SFC>;
        #address-cells = <1>;
        #size-cells = <0>;

        flash@0 {
            compatible = "spi-nand";
            reg = <0>;
            spi-max-frequency = <24000000>;
        };
    };
```
