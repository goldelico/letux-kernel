## Documentation/devicetree/bindings/display/ingenic,x1600-lcd.yaml
```yaml
# SPDX-License-Identifier: (GPL-2.0-only OR BSD-2-Clause)
%YAML 1.2
---
$id: http://devicetree.org/schemas/display/ingenic,x1600-lcd.yaml#
$schema: http://devicetree.org/meta-schemas/core.yaml#

title: Ingenic X1600 LCD controller

maintainers:
  - Olivier Louvignes <olivier@mgcrea.io>

description:
  The display controller of the Ingenic X1600 SoC. It fetches frames through
  descriptors in memory and drives a parallel RGB panel or a smart panel;
  its registers have nothing in common with the controllers described in
  ingenic,lcd.yaml.

properties:
  $nodename:
    pattern: "^lcd-controller@[0-9a-f]+$"

  compatible:
    const: ingenic,x1600-lcd

  reg:
    maxItems: 1

  interrupts:
    maxItems: 1

  clocks:
    items:
      - description: The pixel clock, whose gate also gates the controller

  clock-names:
    items:
      - const: lcd

  port:
    $ref: /schemas/graph.yaml#/properties/port
    description: The output, to the panel or bridge.

required:
  - compatible
  - reg
  - interrupts
  - clocks
  - clock-names
  - port

additionalProperties: false

examples:
  - |
    lcd-controller@13050000 {
        compatible = "ingenic,x1600-lcd";
        reg = <0x13050000 0x10000>;

        interrupt-parent = <&intc>;
        interrupts = <31>;

        clocks = <&cgu 16>;
        clock-names = "lcd";

        port {
            lcd_out: endpoint {
                remote-endpoint = <&panel_in>;
            };
        };
    };
```

## Documentation/devicetree/bindings/display/panel/hiby,lg35583.yaml
```yaml
# SPDX-License-Identifier: (GPL-2.0-only OR BSD-2-Clause)
%YAML 1.2
---
$id: http://devicetree.org/schemas/display/panel/hiby,lg35583.yaml#
$schema: http://devicetree.org/meta-schemas/core.yaml#

title: HiBy LG35583 480x800 panel

maintainers:
  - Olivier Louvignes <olivier@mgcrea.io>

description:
  The 480x800 parallel RGB panel of the HiBy R1, which HiBy calls the
  LG35583. It is set up over a 3-wire SPI bus with 16-bit words.

allOf:
  - $ref: panel-common.yaml#
  - $ref: /schemas/spi/spi-peripheral-props.yaml#

properties:
  compatible:
    const: hiby,lg35583

  reg:
    maxItems: 1

  vcc-supply:
    description: Panel power supply

  vccio-supply:
    description: I/O power supply

  reset-gpios: true
  backlight: true
  port: true

required:
  - compatible
  - reg
  - vcc-supply
  - vccio-supply
  - reset-gpios
  - port

unevaluatedProperties: false

examples:
  - |
    #include <dt-bindings/gpio/gpio.h>

    spi {
        #address-cells = <1>;
        #size-cells = <0>;

        panel@0 {
            compatible = "hiby,lg35583";
            reg = <0>;
            spi-max-frequency = <1000000>;

            vcc-supply = <&vcc_lcd>;
            vccio-supply = <&vccio_lcd>;
            reset-gpios = <&gpa 31 GPIO_ACTIVE_LOW>;
            backlight = <&backlight>;

            port {
                panel_in: endpoint {
                    remote-endpoint = <&lcd_out>;
                };
            };
        };
    };
```

## Documentation/devicetree/bindings/iio/adc/ingenic,x1600-adc.yaml
```yaml
# SPDX-License-Identifier: (GPL-2.0-only OR BSD-2-Clause)
%YAML 1.2
---
$id: http://devicetree.org/schemas/iio/adc/ingenic,x1600-adc.yaml#
$schema: http://devicetree.org/meta-schemas/core.yaml#

title: Ingenic X1600 ADC

maintainers:
  - Olivier Louvignes <olivier@mgcrea.io>

description:
  The SAR ADC of the Ingenic X1600 SoC, with four auxiliary input channels
  measured against a 3.3 V reference.

properties:
  compatible:
    const: ingenic,x1600-adc

  reg:
    maxItems: 1

  clocks:
    maxItems: 1

  interrupts:
    maxItems: 1

  '#io-channel-cells':
    const: 1

required:
  - compatible
  - reg
  - clocks
  - interrupts
  - '#io-channel-cells'

additionalProperties: false

examples:
  - |
    adc@10070000 {
        compatible = "ingenic,x1600-adc";
        reg = <0x10070000 0x30>;

        clocks = <&cgu 28>;

        interrupt-parent = <&intc>;
        interrupts = <11>;

        #io-channel-cells = <1>;
    };
```

## Documentation/devicetree/bindings/sound/openpandora,omap3pandora-sound.yaml
```yaml
# SPDX-License-Identifier: (GPL-2.0-only OR BSD-2-Clause)
%YAML 1.2
---
$id: http://devicetree.org/schemas/sound/openpandora,omap3pandora-sound.yaml#
$schema: http://devicetree.org/meta-schemas/core.yaml#

title: OpenPandora OMAP3 Audio Complex

maintainers:
  - H. Nikolaus Schaller <hns@goldelico.com>

description:
  The OpenPandora audio subsystem describes the routing links between the
  OMAP3 McBSP interface, the external PCM1773 DAC, and the TWL4030 audio codec,
  alongside amplifiers and power supplies.

properties:
  compatible:
    const: openpandora,omap3pandora-sound

  label:
    $ref: /schemas/types.yaml#/definitions/string
    description: User-visible name for this sound card.

  amp-gpios:
    maxItems: 1
    description: GPIO pin controlling the amplifier power state.

  amp-supply:
    description: Regulator supplying power to the amplifier.

  sound-dai:
    $ref: /schemas/types.yaml#/definitions/phandle-array
    minItems: 2
    maxItems: 2
    description:
      Phandles to the audio CPU DAI (OMAP3 McBSP) and the codec DAI.

  routing:
    $ref: /schemas/types.yaml#/definitions/non-unique-string-array
    description:
      A list of the connections between audio components.
      Each entry is a pair of strings, the first being the connection's sink,
      the second being the connection's source.

  widgets:
    $ref: /schemas/types.yaml#/definitions/non-unique-string-array
    description:
      User-specified audio sound widgets.
      Each entry is a pair of strings, the first being the widget type
      (e.g., "Speaker", "Headphone", "Microphone", "Line") and the second being its name.

required:
  - compatible
  - sound-dai

additionalProperties: false

examples:
  - |
    #include <dt-bindings/gpio/gpio.h>

    sound {
        compatible = "openpandora,omap3pandora-sound";
        status = "okay";

        label = "OpenPandora";

        amp-gpios = <&gpio1 14 GPIO_ACTIVE_HIGH>;
        amp-supply = <&regen>;

        widgets =
            "Line", "Line Out",
            "Line", "Line In",
            "Headphone", "Headphone Jack",
            "Microphone", "Mic (internal)",
            "Microphone", "Mic (external)";

        routing =
            "PCM1773 DAC", "APLL Enable",
            "Headphone Amplifier", "PCM1773 DAC",
            "Line Out", "PCM1773 DAC",
            "Headphone Jack", "Headphone Amplifier",
            "AUXL", "Line In",
            "AUXR", "Line In",
            "MAINMIC", "Mic (internal)",
            "Mic (internal)", "Mic Bias 1",
            "SUBMIC", "Mic (external)",
            "Mic (external)", "Mic Bias 2";

        sound-dai = <&mcbsp2>, <&dac>;
    };
```

## Documentation/devicetree/bindings/sound/ti,pcm1773.yaml
```yaml
# SPDX-License-Identifier: (GPL-2.0-only OR BSD-2-Clause)
%YAML 1.2
---
$id: http://devicetree.org/schemas/bindings/sound/ti,pcm1773.yaml#
$schema: http://devicetree.org/meta-schemas/core.yaml#

title: Texas Instruments pcm1773 audio codec

maintainers:
  - to-be-defined@openpandora.org

description: |+
  PCM1771 is a simple stereo audio codec with headphone driver
  that can be enabled through a gpio.

properties:
  compatible:
    const: ti,pcm1773

  enable-gpios:
    maxItems: 1
    description:
      active low GPIO used to enable all outputs

required:
  - compatible

additionalProperties: false

examples:
  - |
    #include <dt-bindings/gpio/gpio.h>

    audio-codec {
      compatible = "ti,pcm1773";
      enable-gpios = <&gpio4 22 GPIO_ACTIVE_LOW>;
    };

...
```

## drivers/gpu/drm/ingenic/Kconfig
```kconfig
config DRM_INGENIC
	tristate "DRM Support for Ingenic SoCs"
	depends on MIPS || COMPILE_TEST
	depends on DRM
	depends on CMA
	depends on OF
	depends on COMMON_CLK
	select DRM_BRIDGE
	select DRM_CLIENT_SELECTION
	select DRM_PANEL
	select DRM_PANEL_BRIDGE
	select DRM_KMS_HELPER
	select DRM_DISPLAY_HELPER
	select DRM_BRIDGE_CONNECTOR
	select DRM_GEM_DMA_HELPER
	select REGMAP
	select REGMAP_MMIO
	help
	  Choose this option for DRM support for the Ingenic SoCs.

	  If M is selected the module will be called ingenic-drm.

config DRM_INGENIC_X1600
	tristate "DRM support for the Ingenic X1600 LCD controller"
	depends on MIPS || COMPILE_TEST
	depends on DRM
	depends on OF
	depends on COMMON_CLK
	select APERTURE_HELPERS
	select DRM_BRIDGE
	select DRM_CLIENT_SELECTION
	select DRM_PANEL_BRIDGE
	select DRM_KMS_HELPER
	select DRM_DISPLAY_HELPER
	select DRM_BRIDGE_CONNECTOR
	select DRM_GEM_DMA_HELPER
	help
	  Choose this option for DRM support for the display controller of
	  the Ingenic X1600 SoC. It drives parallel RGB panels on a 24-bit
	  bus from one full-screen RGB565 plane; the controller's smart panel
	  interface is not supported.

	  If M is selected the module will be called ingenic-x1600-drm.

if DRM_INGENIC

config DRM_INGENIC_IPU
	bool "IPU support for Ingenic SoCs"
	help
	  Choose this option to enable support for the IPU found in Ingenic SoCs.

	  The Image Processing Unit (IPU) will appear as a second primary plane.

config DRM_INGENIC_DW_HDMI
	tristate "Ingenic specific support for Synopsys DW HDMI"
	depends on MACH_JZ4780
	select DRM_DW_HDMI
	help
	  Choose this option to enable Synopsys DesignWare HDMI based driver.
	  If you want to enable HDMI on Ingenic JZ4780 based SoC, you should
	  select this option.

endif
```
