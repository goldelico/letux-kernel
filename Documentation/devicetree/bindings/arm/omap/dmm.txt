## Documentation/devicetree/bindings/arm/omap/dmm.txt
```
OMAP Dynamic Memory Manager (DMM) bindings

Required properties:
- compatible:	Must be "ti,dmm" for OMAP processors containing DMM block
- reg:		Contains timer register address range (base address and length)
- interrupts:	Contains interrupt information (source, etc) for the DMM IRQ
- ti,hwmods:	Name of the hwmod associated to the counter, which is typically
		"dmm"

Example:

dmm: dmm@4e000000 {
	compatible = "ti,dmm";
	reg = <0x4e000000 0x800>;
	ti,hwmods = "dmm";
};
```

## Documentation/devicetree/bindings/display/encoder/solomon,ssd2858.txt
```
Solomon SSD2858 MIPI encoder, compressor, rotator
=================================================

Required properties:
- compatible: "solomon-systech,ssd2858"

Optional properties:
- gpios: enable ssd and disable DCS bypass
- rotate: rotation (0, 90, 180, 270 degrees)
- flip-x, flip-y; additional flip (after applying rotation)

Required nodes:
- ports: an input and an output node

Notes:
- we do not support multiple connected LCDs
- we do not configure all options
- panel timing is used to calculate the ssd setup
- the ssd2858 is limited to forward some DCS commands to
  the panel. If there is a gpio to control a bypass this
  is used if the panel driver wants to send such DCS commands
  to the panel

Example
-------

/*
 * insert ssd2858 driver into pipeline defined by
 * endpoints dsi1_out_ep ---> lcd_in
 */

/ {
	ssd: encoder {
		compatible = "solomon-systech,ssd2858";
		gpios = <&gpio6 2 0>;	/* gpio6_162 = enable ssd and disable DCS bypass */
		rotate = <270>;
		ports {
			#address-cells = <1>;
			#size-cells = <0>;
			port@0 {
				reg = <0>;
				ssd_in: endpoint@0 {
					remote-endpoint = <&dsi1_out_ep>;
				};
			};

			port@1 {
				reg = <1>;
				ssd_out: endpoint@0 {
					remote-endpoint = <&lcd_in>;
				};
			};
		};
	};
};

&lcd_in {
	remote-endpoint = <&ssd_out>;
};

&dsi1_out_ep {
	remote-endpoint = <&ssd_in>;
};
```

## Documentation/devicetree/bindings/display/ingenic,lcd.yaml
```yaml
# SPDX-License-Identifier: (GPL-2.0 OR BSD-2-Clause)
%YAML 1.2
---
$id: http://devicetree.org/schemas/display/ingenic,lcd.yaml#
$schema: http://devicetree.org/meta-schemas/core.yaml#

title: Bindings for Ingenic JZ4780 LCD Controller

maintainers:
  - Paul Cercueil <paul@crapouillou.net>

description: |
  LCD Controller is the Display Controller for the Ingenic JZ47xx SoC

properties:
  compatible:
    oneOf:
     - const: ingenic,jz4725b-lcd
     - const: ingenic,jz4740-lcd
     - const: ingenic,jz4770-lcd
     - const: ingenic,jz4780-lcd

  reg:
    maxItems: 1
    description: LCD registers location and length

  interrupts:
    maxItems: 1
    description: Specifies the interrupt provided by parent

  clocks:
    maxItems: 2
    description: Clock specifiers for LCD pixclock and device clock.
      The device clock is only required on the JZ4740 and JZ4780

  clock-names:
    items:
      - const: lcd
      - const: lcd_pclk

  port:
    type: object
    description: |
      A port node with endpoint definitions as defined in
      Documentation/devicetree/bindings/media/video-interfaces.txt

required:
    - compatible
    - reg
    - interrupts
    - clocks
    - clock-names
    - port

additionalProperties: false

examples:
  - |
    #include <dt-bindings/clock/jz4725b-cgu.h>

    panel {
      compatible = "sharp,ls020b1dd01d";

      backlight = <&backlight>;
      power-supply = <&vcc>;

      port {
        panel_input: endpoint {
          remote-endpoint = <&panel_output>;
          };
        };
      };

    lcd: lcd-controller@13050000 {
      compatible = "ingenic,jz4725b-lcd";
      reg = <0x13050000 0x1000>;

      interrupt-parent = <&intc>;
      interrupts = <31>;

      clocks = <&cgu JZ4725B_CLK_LCD>;
      clock-names = "lcd", "lcd_pclk";

      port {
        panel_output: endpoint {
          remote-endpoint = <&panel_input>;
          };
        };
      };

  - |
    #include <dt-bindings/clock/jz4780-cgu.h>

    lcdc0: lcdc0@13050000 {
        compatible = "ingenic,jz4780-lcd";
        reg = <0x13050000 0x1800>;

        clocks = <&cgu JZ4780_CLK_TVE>, <&cgu JZ4780_CLK_LCD0PIXCLK>;
        clock-names = "lcd", "lcd_pclk";

        interrupt-parent = <&intc>;
        interrupts = <31>;

        jz4780_lcd_out: port {
            #address-cells = <1>;
            #size-cells = <0>;

            jz4780_out_hdmi: endpoint@0 {
                reg = <0>;
                remote-endpoint = <&hdmi_in_lcd>;
            };
        };
    };

    lcdc1: lcdc1@130a0000 {
        compatible = "ingenic,jz4780-lcd";
        reg = <0x130a0000 0x1800>;

        clocks = <&cgu JZ4780_CLK_TVE>, <&cgu JZ4780_CLK_LCD1PIXCLK>;
        clock-names = "lcd", "lcd_pclk";

        interrupt-parent = <&intc>;
        interrupts = <31>;

        status = "disabled";
    };

...
```

## Documentation/devicetree/bindings/display/ingenic-jz4780-drm.txt
```
Ingenic JZ4780 DRM master device
================================

The Ingenic JZ4780 DRM master device is a virtual device needed to list all
devices or other display interface nodes that comprise the graphics subsystem.

Required properties:
- compatible: Should be "ingenic,jz4780-display-subsystem"
- ports: Should contain a list of phandles pointing to display interface port
  as defined in Documentation/devicetree/bindings/video/rockchip-vop.txt

example:

display-subsystem {
	compatible = "ingenic,jz4780-display-subsystem";
	ports = <&jz4780_lcd_out>;
};
```

## Documentation/devicetree/bindings/display/ingenic-jz4780-hdmi.txt
```
Device-Tree bindings for Ingenic JZ4780 HDMI Transmitter

The HDMI Transmitter in the Ingenic JZ4780 is a Synopsys DesignWare HDMI 1.4
TX controller IP with accompanying PHY IP.

Required properties:
 - #address-cells : should be <1>
 - #size-cells : should be <0>
 - compatible : should be "ingenic,jz4780-hdmi"
 - reg-io-width: must be <4>
 - clocks: phandle to isrf and iahb clocks
 - clock-names : must be "isrf" and "iahb"
 - ports: Port nodes with endpoint definitions as defined in
   Documentation/devicetree/bindings/media/video-interfaces.txt,

Optional properties:
 - ddc-i2c-bus: phandle of an I2C controller used for DDC EDID probing

example:

hdmi: hdmi@10180000 {
	compatible = "ingenic,jz4780-hdmi";
	reg = <0x10180000 0x8000>;
	reg-io-width = <4>;
	ddc-i2c-bus = <&i2c4>;
	interrupt-parent = <&intc>;
	interrupts = <3>;
	clocks = <&cgu JZ4780_CLK_HDMI>, <&cgu JZ4780_CLK_AHB0>;
	clock-names = "isfr", "iahb";

	ports {
		hdmi_in: port {
			#address-cells = <1>;
			#size-cells = <0>;
			hdmi_in_lcd: endpoint@0 {
				reg = <0>;
				remote-endpoint = <&jz4780_out_hdmi>;
			};
		};
	};
};
```

## Documentation/devicetree/bindings/display/ingenic-jz4780-hdmi.yaml
```yaml
# SPDX-License-Identifier: (GPL-2.0 OR BSD-2-Clause)
%YAML 1.2
---
$id: http://devicetree.org/schemas/display/ingenic-jz4780-hdmi.yaml#
$schema: http://devicetree.org/meta-schemas/core.yaml#

title: Bindings for Ingenic JZ4780 HDMI Transmitter

maintainers:
  - H. Nikolaus Schaller <hns@goldelico.com>

description: |
  The HDMI Transmitter in the Ingenic JZ4780 is a Synopsys DesignWare HDMI 1.4
  TX controller IP with accompanying PHY IP.

allOf:
  - $ref: bridge/synopsys,dw-hdmi.yaml#

properties:
  compatible:
    enum: ingenic,jz4780-dw-hdmi

  reg:
    maxItems: 1

  reg-io-width:
    const: 4

  interrupts:
    maxItems: 1

  clocks:
    maxItems: 2
    description: Clock specifiers for isfr and iahb clocks

  clock-names:
    items:
      - const: isfr
      - const: iahb

  hdmi-5v-supply:
    description: Optional regulator to provide +5V at the connector

  ddc-i2c-bus:
    description: An I2C interface if the internal DDC I2C driver is not to be used

  ports:
    $ref: /schemas/graph.yaml#/properties/ports

required:
    - compatible
    - clocks
    - clock-names
    - ports
    - reg-io-width

additionalProperties: false

examples:
  - |
    #include <dt-bindings/clock/jz4780-cgu.h>

    hdmi: hdmi@10180000 {
        compatible = "ingenic,jz4780-dw-hdmi";
        reg = <0x10180000 0x8000>;
        reg-io-width = <4>;
        ddc-i2c-bus = <&i2c4>;
        interrupt-parent = <&intc>;
        interrupts = <3>;
        clocks = <&cgu JZ4780_CLK_HDMI>, <&cgu JZ4780_CLK_AHB0>;
        clock-names = "isfr", "iahb";

        ports {
            hdmi_in: port@0 {
                reg = <0>;
                dw_hdmi_in: endpoint {
                    remote-endpoint = <&jz4780_lcd_out>;
                };
            };
            hdmi_out: port@1 {
                reg = <1>;
                dw_hdmi_out: endpoint {
                    remote-endpoint = <&hdmi_con>;
                };
            };
        };
    };

...
```

## Documentation/devicetree/bindings/display/ingenic-jz4780-lcd.txt
```
Bindings for Ingenic JZ4780 LCD Controller

LCD Controller is the Display Controller for the Ingenic JZ4780 SoC

Required properties:
- compatible: should be "ingenic,jz4780-lcd"
- reg: Should contain the address & size of the LCD controller registers.
- interrupts: Should specify the interrupt provided by parent.
- clocks: Should contain two clock specifiers for the JZ4780_CLK_TVE JZ4780_CLK_LCD0PIXCLK.
- clock-names : Must be "lcd_clk", "lcd_pixclk";
- port: A port node with endpoint definitions as defined in
  Documentation/devicetree/bindings/media/video-interfaces.txt.

Optional properties:
- interrupt-parent: phandle to parent interrupt controller

Example:

lcd: jz4780-lcdk@0x13050000 {
	compatible = "ingenic,jz4780-lcd";
	reg = <0x13050000 0x1800>;

	clocks = <&cgu JZ4780_CLK_TVE>, <&cgu JZ4780_CLK_LCD0PIXCLK>;
	clock-names = "lcd_clk", "lcd_pixclk";

	interrupt-parent = <&intc>;
	interrupts = <31>;

	jz4780_lcd_out: port {
			#address-cells = <1>;
			#size-cells = <0>;

			jz4780_out_hdmi: endpoint@0 {
				reg = <0>;
				remote-endpoint = <&hdmi_in_lcd>;
			};
		};

};
```

## Documentation/devicetree/bindings/display/ingenic-jz4780-lcd.yaml
```yaml
# SPDX-License-Identifier: (GPL-2.0 OR BSD-2-Clause)
%YAML 1.2
---
$id: http://devicetree.org/schemas/display/ingenic-jz4780-lcd.yaml#
$schema: http://devicetree.org/meta-schemas/core.yaml#

title: Bindings for Ingenic JZ4780 LCD Controller

maintainers:
  - Zubair Lutfullah Kakakhel <Zubair.Kakakhel@imgtec.com>
  - H. Nikolaus Schaller <hns@goldelico.com>

description: |
  LCD Controller is the Display Controller for the Ingenic JZ4780 SoC

properties:
  compatible:
    items:
      - const: ingenic,jz4780-lcd

  reg:
    maxItems: 1
    description: the address & size of the LCD controller registers

  interrupts:
    maxItems: 1
    description: Specifies the interrupt provided by parent

  clocks:
    maxItems: 2
    description: Clock specifiers for the JZ4780_CLK_TVE JZ4780_CLK_LCD0PIXCLK

  clock-names:
    items:
      - const: lcd_clk
      - const: lcd_pixclk

  port:
    type: object
    description: |
      A port node with endpoint definitions as defined in
      Documentation/devicetree/bindings/media/video-interfaces.txt

required:
    - compatible
    - reg
    - interrupts
    - clocks
    - clock-names
    - port

additionalProperties: false

examples:
  - |
    #include <dt-bindings/clock/jz4780-cgu.h>
    lcd: jz4780-lcdc@13050000 {
        compatible = "ingenic,jz4780-lcd";
        reg = <0x13050000 0x1800>;

        clocks = <&cgu JZ4780_CLK_TVE>, <&cgu JZ4780_CLK_LCD0PIXCLK>;
        clock-names = "lcd_clk", "lcd_pixclk";

        interrupt-parent = <&intc>;
        interrupts = <31>;

        jz4780_lcd_out: port {
            #address-cells = <1>;
            #size-cells = <0>;

            jz4780_out_hdmi: endpoint@0 {
                reg = <0>;
                remote-endpoint = <&hdmi_in_lcd>;
            };
        };
    };

...
```

## Documentation/devicetree/bindings/extcon/extcon-gpio-usbvid.txt
```
EXTCON FOR USB VIA GPIO

Required Properties:
 - compatible : Should be "ti,gpio-usb-vid" for USB VBUS-ID detector
		using gpios or "ti,gpio-usb-id" for USB ID pin detector
 - gpios : phandle and args ID pin gpio and VBUS gpio.
	   The first gpio used  for ID pin detection
	   and the second used for VBUS detection.
	   ID pin gpio is mandatory and VBUS is optional
	   depending on implementation.
- interrupt_mode : set to 1 for usb ID pin detection can by interrupt mode
		   set to 0 for usb ID pin detection by polling mode.
- dr_mode : set to "host", "peripheral" or "otg" for respective usb modes.

Please refer to ../gpio/gpio.txt for details of the common GPIO bindings

Example:

	gpio_usbvid_extcon1 {
		compatible = "ti,gpio-usb-vid";
		gpios = <&gpio1 1 0>,
			<&gpio2 2 0>;
		interrupt_mode = <0>;
		dr_mode = "otg";
	};
```

## Documentation/devicetree/bindings/gnss/sirfstar.txt
```
SiRFstar-based GNSS Receiver DT binding

SiRFstar chipsets are used in GNSS-receiver modules produced by several
vendors and can use UART, SPI or I2C interfaces.

Please see Documentation/devicetree/bindings/gnss/gnss.txt for generic
properties.

Required Properties:

- compatible 	: Must be one of

			"fastrax,uc430"
			"linx,r4"
			"wi2wi,w2sg0008i"
			"wi2wi,w2sg0084i"

- vcc-supply	: Main voltage regulator (3V3_IN, VDD, VCC)

Optional Properties:

- enable-gpios	: GPIO used to power on and off device (ON_OFF)
- wakeup-gpios	: GPIO used to determine device power state (WAKEUP, RFPWRUP)
- timepulse-gpios	: Timepulse (e.g 1PPS) GPIO (1PPS, TM)

Example:

serial@1234 {
	compatible = "ns16550a";

	gnss {
		compatible = "wi2wi,w2sg0084i";

		vcc-supply = <&gnss_reg>;
		enable-gpios = <&gpio0 16 GPIO_ACTIVE_HIGH>;
		wakeup-gpios = <&gpio0 17 GPIO_ACTIVE_HIGH>;
	};
};
```

## Documentation/devicetree/bindings/gnss/u-blox.txt
```
u-blox GNSS Receiver DT binding

The u-blox GNSS receivers can use UART, DDC (I2C), SPI and USB interfaces.

Please see Documentation/devicetree/bindings/gnss/gnss.txt for generic
properties.

Required Properties:

- compatible 	: Must be one of

			"u-blox,neo-8"
			"u-blox,neo-m8"

- vcc-supply	: Main voltage regulator (VCC)

Optional Properties:

- timepulse-gpios	: Timepulse (e.g. 1PPS) GPIO (TIMEPULSE)

Example:

serial@1234 {
	compatible = "ns16550a";

	gnss {
		compatible = "u-blox,neo-8";

		vcc-supply = <&gnss_reg>;
	};
};
```
