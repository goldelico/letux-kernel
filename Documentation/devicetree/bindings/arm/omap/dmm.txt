## Documentation/devicetree/bindings/gpu/img,pvrsgx.yaml
```yaml
# SPDX-License-Identifier: GPL-2.0
%YAML 1.2
---
$id: http://devicetree.org/schemas/gpu/img,pvrsgx.yaml#
$schema: http://devicetree.org/meta-schemas/core.yaml#

title: Imagination PVR/SGX GPU

maintainers:
  - H. Nikolaus Schaller <hns@goldelico.com>

description: |+
  This binding describes the Imagination SGX5 series of 3D accelerators which
  are found in several different SoC like TI OMAP, Sitara, Ingenic JZ4780,
  Allwinner A83, and Intel Poulsbo and CedarView and more.

  For an almost complete list see: https://en.wikipedia.org/wiki/PowerVR#Implementations
  
  Only the Imagination SGX530, SGX540 and SGX544 GPUs are currently covered by
  this binding but the extension of the pattern is straightforward.
  
  The SGX node is usually a child node of some DT node belonging to the SoC
  which handles clocks, reset and general address space mapping of the SGX
  register area.

properties:
  compatible:
    enum:
    # BeagleBoard ABC, OpenPandora 600MHz
      - ti,omap3-sgx530-121, img,sgx530-121, img,sgx530, img,sgx5
    # BeagleBoard XM, GTA04, OpenPandora 1GHz
      - ti,omap3-sgx530-125, img,sgx530-125, img,sgx530, img,sgx5
    # BeagleBone Black
      - ti,am3352-sgx530-125, img,sgx530-125, img,sgx530, img,sgx5
    # Pandaboard, Pandaboard ES
      - ti,omap4-sgx540-120, img,sgx540-120, img,sgx540, img,sgx5
      - ti,omap4-sgx544-112, img,sgx544-112, img,sgx544, img,sgx5
    # OMAP5 UEVM, Pyra Handheld
      - ti,omap5-sgx544-116, img,sgx544-116, img,sgx544, img,sgx5
      - ti,dra7-sgx544-116, img,sgx544-116, img,sgx544, img,sgx5
    # CI20
      - ingenic,jz4780-sgx540-120, img,sgx540-120, img,sgx540, img,sgx5
    # the following entries are not validated with real hardware
    # more TI
      - ti,am3517-sgx530-125, img,sgx530-125, img,sgx530, img,sgx5
      - ti,am4-sgx530-125, img,sgx530-125, img,sgx530, img,sgx5
      - ti,ti81xx-sgx530-125, img,sgx530-125, img,sgx530, img,sgx5
    # Banana-Pi-M3 (Allwinner A83T)
      - allwinner,sun8i-a83t-sgx544-116, img,sgx544-116, img,sgx544, img,sgx5
    # Atom Z5xx
      - intel,poulsbo-gma500-sgx535, img,sgx535-116, img,sgx535, img,sgx5
    # Atom Z24xx
      - intel,medfield-gma-sgx540, img,sgx540-116, img,sgx540, img,sgx5
    # Atom N2600, D2500
      - intel,cedarview-gma3600-sgx545, img,sgx545-116, img,sgx545, img,sgx5

  reg:
    maxItems: 1
    description: physical base address and length of the register area

  interrupts:
    maxItems: 1
    description: interrupt line from SGX subsystem to core processor

  clocks:
    description: optional clocks

required:
  - compatible
  - reg
  - interrupts

examples:
  - |+
    #include <dt-bindings/interrupt-controller/arm-gic.h>

    gpu@fe00 {
      compatible = "ti,omap-omap5-sgx544-116", "img,sgx544-116", "img,sgx544", "img,sgx5";
      reg = <0xfe00 0x200>;
      interrupts = <GIC_SPI 21 IRQ_TYPE_LEVEL_HIGH>;
    };

...
```

## Documentation/devicetree/bindings/hwmon/twl4030-madc-hwmon.txt
```
TWL4030 MADC hwmon.

Required properties:
- compatible: "ti,twl4030-madc-hwmon"

Example:
madc-hwmon {
	compatible = "ti,twl4030-madc-hwmon";
};
```

## Documentation/devicetree/bindings/iio/gyroscope/bmg160.txt
```
* Bosch BMG160 triaxial rotation sensor (gyroscope)

Required properties:

  - compatible : should be "bosch,bmg160" or "bosch,bmi055_gyro"
  - reg : the I2C address of the sensor (0x69)

Example:

bmg160@69 {
	compatible = "bosch,bmg160";
	reg = <0x69>;
};
```

## Documentation/devicetree/bindings/iio/light/vcnl4000.txt
```
* VCNL4000 Proximity and ambient light sensor.

Required properties:

  - compatible : should be one of
	"vishay,vcnl4000"
	"vishay,vcnl4010"
	"vishay,vcnl4020"
	"vishay,vcnl4200"
  - reg : the I2C address of the sensor
	0x13 for vcnl40x0
	0x51 for vcnl4200

Example:

&i2c1 {
	vcnl4010@13 {
		compatible = "vishay,vcnl4010";
		reg = <0x13>;
	};
};
```

## Documentation/devicetree/bindings/input/touchscreen/tsc2007.txt
```
* Texas Instruments tsc2007 touchscreen controller

Required properties:
- compatible: must be "ti,tsc2007".
- reg: I2C address of the chip.
- ti,x-plate-ohms: X-plate resistance in ohms.

Optional properties:
- gpios: the interrupt gpio the chip is connected to (trough the penirq pin).
  The penirq pin goes to low when the panel is touched.
  (see GPIO binding[1] for more details).
- interrupt-parent: the phandle for the gpio controller
  (see interrupt binding[0]).
- interrupts: (gpio) interrupt to which the chip is connected
  (see interrupt binding[0]).
- touchscreen-swap-xy: if present, swap x and y values. Rotation left/right is
  achieved by combination with flipping of x or y.
- touchscreen-start-x: minimum x (default 0). Use this for a coarse calibration of the
  touch if there is no user space option (e.g. Android, X11).
- touchscreen-size-x: maximum x (default 4095). If max-x is smaller than min-x the
  axis is swapped.
- touchscreen-start-y: minimum y (default 0).
- touchscreen-size-y: maximum y (default 4095).
- touchscreen-min-pressure: minimum pressure (default 0).
- touchscreen-max-pressure: maximum pressure (default 4095). Depending on your needs, you
  can also invert the pressure value since the raw rt value  reports the
  resistance and not the "pressure" (i.e. becomes lower for higher pressure).
- touchscreen-fuzz-x: specifies the absolute input fuzz x value.
  If set, it will permit noise in the data up to +- the value given to the fuzz
  parameter, that is used to filter noise from the event stream (default 0).
- touchscreen-fuzz-y: specifies the absolute input fuzz y value.
- touchscreen-fuzz-pressure: specifies the absolute input fuzz z value.
- ti,poll-period: how much time to wait (in milliseconds) before reading again the
  values from the tsc2007 (default 1).

[0]: Documentation/devicetree/bindings/interrupt-controller/interrupts.txt
[1]: Documentation/devicetree/bindings/gpio/gpio.txt

Example:
	&i2c1 {
		/* ... */
		tsc2007@49 {
			compatible = "ti,tsc2007";
			reg = <0x49>;
			interrupt-parent = <&gpio4>;
			interrupts = <0x0 0x8>;
			gpios = <&gpio4 0 0>;
			ti,x-plate-ohms = <180>;
		};

		/* ... */
	};
```

## Documentation/devicetree/bindings/leds/is31fl319x.txt
```
LEDs connected to is31fl319x LED controller chip

Required properties:
- compatible : Should be any of
	"issi,is31fl3190"
	"issi,is31fl3191"
	"issi,is31fl3193"
	"issi,is31fl3196"
	"issi,is31fl3199"
	"si-en,sn3199".
- #address-cells: Must be 1.
- #size-cells: Must be 0.
- reg: 0x64, 0x65, 0x66, 0x67.

Optional properties:
- led-max-microamp : See Documentation/devicetree/bindings/leds/common.txt.
	Valid values: 5000 - 40000, step by 5000 (rounded down)
	Default: 20000 (20 mA)
- audio-gain-db : audio gain selection for external analog modulation input.
	Valid values: 0 - 21, step by 3 (rounded down)
	Default: 0

Each led is represented as a sub-node of the issi,is31fl319x device.
There can be less leds subnodes than the chip can support but not more.

LED sub-node properties:
- label : (optional) see Documentation/devicetree/bindings/leds/common.txt.
- reg : number of LED line
	Valid values: 1 - number of leds supported by the chip variant.
- linux,default-trigger : (optional)
	see Documentation/devicetree/bindings/leds/common.txt.

Examples:

fancy_leds: leds@65 {
	compatible = "issi,is31fl3196";
	#address-cells = <1>;
	#size-cells = <0>;
	reg = <0x65>;

	red_aux: led@1 {
		label = "red:aux";
		reg = <1>;
	};

	green_power: led@5 {
		label = "green:power";
		reg = <5>;
		linux,default-trigger = "default-on";
	};
};
```

## Documentation/devicetree/bindings/media/i2c/ov9655.txt
```
* Omnivision OV9655 CMOS sensor

The Omnivision OV9655 sensor support multiple resolutions output, such as
CIF, SVGA, UXGA. It also can support YUV422/420, RGB565/555 or raw RGB
output format.

Required Properties:
- compatible: should be one of
	"ovti,ov9155"
	"ovti,ov9655"
- clocks: reference to the xclk input clock.

Optional Properties:
- resetb-gpios: reference to the GPIO connected to the RESETB pin, if any,
		polarity is active low.
- pwdn-gpios: reference to the GPIO connected to the PWDN pin, if any,
		polarity is active high.
- avdd-supply: reference to the analog power supply regulator connected
		to the AVDD pin, if any.
- dvdd-supply: reference to the digital power supply regulator connected
		to the DVDD pin, if any.
- dovdd-supply: reference to the digital I/O power supply regulator
		connected to the DOVDD pin, if any.


The device node must contain one 'port' child node for its digital output
video port, in accordance with the video interface bindings defined in
Documentation/devicetree/bindings/media/video-interfaces.txt.

Optional General Properties:
- bus-width:		bus width of the camera output. Default is 10.
- hsync-active:		HSYNC polarity. Default is 0.
- vsync-active:		VSYNC polarity. Default is 0.
- data-active:		data active polarity. Default is 1.
- pclk-sample:		clock sampling edge. Default is 0.
- clock-noncontinuous	boolean property for pclk output option. Default is 0.
- slave-mode		switch to slave mode.

Optional Properties for OV9655 only:
- pclk-delay:		clock delay in 2ns steps. Default is 2.
- output-drive:		driver strength. Default is 1.

See data sheet for definition of constants.

Example:

&i2c2 {
	ov9655@30 {
		pinctrl-names = "default";
		pinctrl-0 = <&camera_pins>;
		compatible = "ovti,ov9655";
		reg = <0x30>;
		reset-gpios = <&gpio3 2 0>,	/* reset cam_fld = GPIO_98 */
		pwdn-gpios = <&gpio6 7 0>;	/* pwdn cam_wen = GPIO_167 */
		avdd-supply = <&vaux3>;
		clocks = <&isp 0>;	/* cam_clka */

		port {
			ov9655: endpoint {
				bus-width = <8>;
				remote-endpoint = <&parallel_ep>;
				hsync-active = <0>;	/* Active low */
				vsync-active = <1>;	/* Active high */
				pclk-sample = <1>;	/* Rising */
			};
		};
	};
};
```

## Documentation/devicetree/bindings/media/i2c/ov965x.txt
```
* Omnivision OV9650/9652/9655 CMOS sensor

The Omnivision OV965x sensor support multiple resolutions output, such as
CIF, SVGA, UXGA. It also can support YUV422/420, RGB565/555 or raw RGB
output format.

Required Properties:
- compatible: should be one of
	"ovti,ov9650"
	"ovti,ov9652"
	"ovti,ov9655"
- clocks: reference to the xclk input clock.
- clock-frequency: clock frequency in Hz.
- gpios: reference to the GPIO connected to the reset(b) pin and pwdn pin.
	Specify GPIO polarity as defined by data sheet (reset / resetb).

Optional Properties:
- vana-supply: a reglator to power up the camera module.

The device node must contain one 'port' child node for its digital output
video port, in accordance with the video interface bindings defined in
Documentation/devicetree/bindings/media/video-interfaces.txt.

Example:

&i2c2 {
	ov9655@30 {
		pinctrl-names = "default";
		pinctrl-0 = <&camera_pins>;
		compatible = "ovti,ov9655";
		reg = <0x30>;
		gpios = <&gpio3 2 0>,	/* reset cam_fld = GPIO_98 */
			<&gpio6 7 0>;	/* pwdn cam_wen = GPIO_167 */
		vana-supply = <&vaux3>;
		clocks = <&isp 0>;	/* cam_clka */
		clock-frequency = <24000000>;

		port {
			ov9655: endpoint {
				bus-width = <8>;
				remote-endpoint = <&parallel_ep>;
				hsync-active = <1>;
				vsync-active = <1>;
				data-active = <1>;	/* Active High */
				pclk-sample = <1>;	/* Rising */
			};
		};
	};
};
```

## Documentation/devicetree/bindings/media/i2c/tvp5158.txt
```
* Texas Instruments TVP5158 video decoder

The TVP5158 device is high quality, single-chip
digital video decoder that digitizes and decodes all popular baseband analog
video formats into digital video component. The tvp5158 decoder supports
decoding of NTSC, PAL and SECAM composite and S-video.

TVP5158 generates output in BT656 format with embedded sync.

Required Properties :
- compatible : Must be "ti,tvp5158"
- mux-gpios : A list of gpios with active high/low flags for enabling the sensor.
         This may contain gpios for power, board muxes, etc. Driver would
         set all of them as specified by the active high/low flag.

Optional Properties :
  There are no custom optional properties although the driver supports
  standard endpoint properties as documented in
  Documentation/devicetree/bindings/media/video-interfaces.txt

Example:

	&i2c2 {
		...
		...
		tvp5158@5c {
			compatible = "ti,tvp5158";
			reg = <0x58>;

			mux-gpios = <&pcf_hdmi 3    GPIO_ACTIVE_LOW>;

			port {
				tvp_decoder: endpoint {
					/* No properties for BT 656 */
				};
			};
		};
		...
	};
```

## Documentation/devicetree/bindings/mfd/tps65917.txt
```
* TPS65917 device tree bindings

The TI TPS65917 family of PMICs.

Required properties:
- compatible : Should be from the list
  ti,tps65917
- interrupt-controller : TPS65917 has its own internal IRQs
- #interrupt-cells : should be set to 2 for IRQ number and flags
  The first cell is the IRQ number.
  The second cell is the flags, encoded as the trigger masks from
  Documentation/devicetree/bindings/interrupts.txt
- interrupt-parent : The parent interrupt controller.

Optional properties:
  ti,mux-padX : set the pad register X (1-2) to the correct muxing for the
		hardware, if not set will use muxing in OTP.

Example:

tps65917 {
	compatible = "ti,tps65917";
	reg = <0x58>
	interrupt-parent = <&intc>;
	interrupt-controller;
	#interrupt-cells = <2>;

	#address-cells = <1>;
	#size-cells = <0>;

	pmic {
		compatible = "ti,tps65917-pmic";
		....
	};
}
```

## Documentation/devicetree/bindings/mfd/twl4030-madc.txt
```
Texas Instruments TWL family (twl4030) analog signal conversion monitor module

Required properties:
- compatible : must be "ti,twl4030-madc"
- interrupts : interrupt number

Example:
twl: twl@48 {
	reg = <0x48>;
	interrupts = <7>; /* SYS_NIRQ cascaded to intc */
	interrupt-parent = <&intc>;

	twl_madc: madc {
		compatible = "ti,twl4030-madc";
		interrupts = <1>;
	};
};
```

## Documentation/devicetree/bindings/misc/wi2wi,w2sg0004.txt
```
Wi2Wi GPS module connected through UART

Should be a subnode of the SoC UART it is connected to (serdev).

Required properties:
- compatible:	wi2wi,w2sg0004 or wi2wi,w2sg0084
- on-off-gpio:	the GPIO that controls the module's on-off toggle input

Optional properties:
- lna-suppy:	an (optional) LNA regulator that is enabled together with the GPS receiver

Example:

&uart2 {
	gps: w2sg0004 {
		compatible = "wi2wi,w2sg0004";
		lna-supply = <&vsim>;   /* LNA regulator */
		on-off-gpios = <&gpio5 17 GPIO_ACTIVE_HIGH>;    /* GPIO_145: trigger for turning on/off w2sg0004 */
        };
};
```
