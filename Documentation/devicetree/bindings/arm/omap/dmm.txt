## Documentation/devicetree/bindings/mmc/ti-omap-hsmmc.txt
```
* TI Highspeed MMC host controller for OMAP

The Highspeed MMC Host Controller on TI OMAP family
provides an interface for MMC, SD, and SDIO types of memory cards.

This file documents differences between the core properties described
by mmc.txt and the properties used by the omap_hsmmc driver.

Required properties:
- compatible:
 Should be "ti,omap2-hsmmc", for OMAP2 controllers
 Should be "ti,omap3-hsmmc", for OMAP3 controllers
 Should be "ti,omap4-hsmmc", for OMAP4 controllers
- ti,hwmods: Must be "mmc<n>", n is controller instance starting 1

Optional properties:
ti,dual-volt: boolean, supports dual voltage cards
<supply-name>-supply: phandle to the regulator device tree node
"supply-name" examples are "vmmc", "vmmc_aux" etc
ti,non-removable: non-removable slot (like eMMC)
ti,needs-special-reset: Requires a special softreset sequence
ti,needs-special-hs-handling: HSMMC IP needs special setting for handling High Speed
dmas: DMA controller phandle and DMA request value ordered pair
One tx and one rx pair is required.
dma-names: DMA request names. These strings correspond 1:1 with
the ordered pairs in dmas. The RX request must be "rx" and the
TX request must be "tx".

Examples:

[hwmod populated DMA resources]

	mmc1: mmc@0x4809c000 {
		compatible = "ti,omap4-hsmmc";
		reg = <0x4809c000 0x400>;
		ti,hwmods = "mmc1";
		ti,dual-volt;
		bus-width = <4>;
		vmmc-supply = <&vmmc>; /* phandle to regulator node */
		ti,non-removable;
	};

[generic DMA request binding]

	mmc1: mmc@0x4809c000 {
		compatible = "ti,omap4-hsmmc";
		reg = <0x4809c000 0x400>;
		ti,hwmods = "mmc1";
		ti,dual-volt;
		bus-width = <4>;
		vmmc-supply = <&vmmc>; /* phandle to regulator node */
		ti,non-removable;
		dmas = <&edma 24
			&edma 25>;
		dma-names = "tx", "rx";
	};

OMAP HSMMC CONTROL

Required properties:
- compatible: Should be "ti,omap-hsmmc-control"
- reg : Address and length of the register set for the device. It contains
 the address of "pbias" and/or "prog_io1" and/or "ctrl_mmc1" and/or "devconf1"
 and/or "devconf0"
- reg-names: The names of the register addresses corresponding to the registers
 filled in "reg".
- ti,ctrl-type: This is used to differentiate mmc1, mmc2 on different
 omap SOCs like 2430, omap3, omap3630, omap4, omap5.
 MMC1 pbias programming is same for omap2430 and omap3 but differs across
 omap3,4,5.
 Should be "0" for no control mmc module configuration
 Should be "1" for MMC1 on OMAP2430 for MMC1 pbias, loopback
  and speed mode configuration
 Should be "2" for MMC2 on OMAP2430, OMAP3 for loopback clock configuration
 Should be "3" for MMC1 on OMAP3430 for MMC1 pbias, loopback
  and speed mode configuration
 Should be "4" for MMC1 on OMAP3630 for MMC1 pbias, loopback
  and speed mode configuration
 Should be "5" for MMC1 on OMAP4 for MMC1 pbias configuration
 Should be "6" for MMC2 on OMAP4 for loopback clock configuration
 Should be "7" for MMC1 on OMAP5 for MMC1 pbias configuration

Example:
omap_control_mmc1: omap-hsmmc-control@4A100600 {
	compatible = "ti,omap-hsmmc-control";
	reg = <0x4A100600 0x4>,
	      <0x4A100628 0x4>;
	reg-names = "pbias", "mmc1";
	ctrl-type = <5>;
};
```
