## Documentation/devicetree/bindings/sound/pcm1773.yaml
```yaml
# SPDX-License-Identifier: None
%YAML 1.2
---
$id: http://devicetree.org/schemas/bindings/sound/pcm1773.yaml#
$schema: http://devicetree.org/meta-schemas/core.yaml#

title: Texas Instruments pcm1773 audio codec

maintainers:
  - to-be-defined@openpandora.org

description: |+
  PCM1771 is a simple audio codec that can be enabled
  through a gpio.

properties:
  compatible:
    const: ti,pcm1773

required:
  - compatible

additionalProperties: false

examples:
  - |
    audio-codec {
      compatible = "ti,pcm1773";
      enable-gpios = <&gpio4 22 GPIO_ACTIVE_LOW>;
    };

...
```

## Documentation/devicetree/bindings/video/dvi-connector.txt
```
DVI Connector
==============

Required properties:
- compatible: "dvi-connector"

Optional properties:
- label: a symbolic name for the connector
- i2c-bus: phandle to the i2c bus that is connected to DVI DDC

Required nodes:
- Video port for DVI input

Example
-------

dvi0: connector@0 {
	compatible = "dvi-connector";
	label = "dvi";

	i2c-bus = <&i2c3>;

	dvi_connector_in: endpoint {
		remote-endpoint = <&tfp410_out>;
	};
};
```

## Documentation/devicetree/bindings/video/fpd3-serdes.txt
```
Texas instruments video serializer de serializer
================================================

See Documentation/video-serdes.txt for generic information about
video serializer / de serializers.

FPDlink3 video serdes devices are I2C slave devices. They are always
used in pairs where one device is connected to the CPU/SoC which is
called local device and the other one is called remote device.

FPDlink3 video serdes devices have some gpios which can be controlled
over I2C. Also, the FPDlink supports gpio forwarding. Which means that
the remote device can copy the gpio values from it's remote device.

Also, each of the remote device is an I2C master itself, so it can
interface some I2C slaves at remote end. For e.g, a backlight LCD chip
connected to the de serializer or the camera connected to a serializer.
So these slaves can be accessed from local devices via I2C aliases.

A pair of serializer/deserializer can be used for tunneling the i2c
transactions over LVDS channel. The one of the device is connected to
the system i2c bus in slave mode and the other one acts as a master
at the remote end. But, the slave device can register dummy aliases
remote master and for each of the remote slaves.
As this is acting like a i2c bridge driver, we need a method for
configuring the address translations.

Required Properties:

  - compatible: should be one of the following.
    - "ti,ds90ub913aq": For TI FPDlink3 12bit video serializer
    - "ti,ds90ub914aq": For TI FPDlink3 12bit video de serializer
    - "ti,ds90uh925q": For TI FPDlink3 24bit video serializer
    - "ti,ds90uh928q": For TI FPDlink3 24bit video de serializer

  - reg: I2C slave address
	This would be the alias adress for remote device. The CPU side
	ser/des would address the remote device using this address.

Optional Properties:

  - gpio-controller: Marks the device node as a gpio controller.
  - #gpio-cells: Should be 1. The first cell is the GPIO number.

  - ranges: This is the address translation table for mapping i2c devices
	on the remote bus to the i2c address(alias) on parent bus.
	The first entry in the ranges property has to of the corresponding
	remote ser/des device.
	For dynamic address mapping, keep the remote slave address as 0x0
	The corresponding alias would be used if the remote slave doesn't
	have an address already mapped.

  - slave-mode: This property marks the ser/des as remote device.
	For a device where 'slave-mode' property is absent, it is considered
	as master device and 'ranges' and 'i2c-bus-num' properties are
	compulsory.

Example:

Following example demonstrates device node structure for a camera connected
using FPDlink3 ser/des. Here the deserializer and serializer are connected
only via the LVDS link. The camera is connected on the serializer i2c bus.
Here, serializer and camera are not connected to the system i2c bus, but it
can be accessed from the system i2c bus. The deserializer maps each of the
remote slave onto the system i2c bus and acts as a bridge to transfer any
messages addressed to the remote devices.

=======================================
+-------+
|I2C bus|
+-------+
  |
  |0x60<real> +------------+
  +-----------|Deserializer|0x60
  |           +------------+
  |                X
  |                X
  |                X <LVDS link>
  |                X
  |                X
  |           +----------+
  |           |  Remote  |
  |           |  i2c bus |
  |           +----------+
  |              |
  |0x74<alias>   |      +----------+
  | <-  -  -  -  +------|Serializer| 0x58
  |              |      +----------+
  |              |
  |0x38<alias>   |      +---------+
  | <-  -  -  -  +------|OV Camera| 0x30
  |              |      +---------+
  |
  |
=======================================

i2cbus {
	lvds_des: deserializer@60 {
		compatible = "ti,ds90ub914aq";
		reg = <0x60>;

		gpio-controller;
		#gpio-cells=1;

		i2c-bus-num = <5>;
	};
};

&lvds_des {

	ranges = <0x58 0x74>,
		 <0x38 0x30>;

	lvds_ser: serializer@58 {
		compatible = "ti,ds90ub913aq";
		reg = <0x58>;
		remote-device = <&lvds_des>;

		gpio-controller;
		#gpio-cells=1;

		slave-mode;
	};

	lvds_cam: camera@30 {
		compatible = "ov10635"
		reg = <0x30>;

		gpios = <&lvds_ser 0>;
		/* power pin controlled by serializer local gpio */
	};
};
```

## Documentation/devicetree/bindings/video/panel-dsi-cm.txt
```
Generic MIPI DSI Command Mode Panel
===================================

Required properties:
- compatible: "panel-dsi-cm"

Optional properties:
- label: a symbolic name for the panel
- gpios: panel reset gpio and TE gpio

Required nodes:
- Video port for DSI input

Example
-------

lcd0: display {
	compatible = "tpo,taal", "panel-dsi-cm";
	label = "lcd0";

	gpios = <&gpio4 6 GPIO_ACTIVE_HIGH>;	/* 102, reset */

	lcd0_in: endpoint {
		remote-endpoint = <&dsi1_out_ep>;
	};
};
```

## Documentation/devicetree/bindings/video/ti,omap4-dss.txt
```
Texas Instruments OMAP4 Display Subsystem
=========================================

See Documentation/devicetree/bindings/video/ti,omap-dss.txt for generic
description about OMAP Display Subsystem bindings.

DSS Core
--------

Required properties:
- compatible: "ti,omap4-dss"
- reg: address and length of the register space
- ti,hwmods: "dss_core"

Required nodes:
- DISPC

Optional nodes:
- DSS Submodules: RFBI, VENC, DSI, HDMI
- Video port for DPI output

DPI Endpoint required properties:
- data-lines: number of lines used


DISPC
-----

Required properties:
- compatible: "ti,omap4-dispc"
- reg: address and length of the register space
- ti,hwmods: "dss_dispc"
- interrupts: the DISPC interrupt


RFBI
----

Required properties:
- compatible: "ti,omap4-rfbi"
- reg: address and length of the register space
- ti,hwmods: "dss_rfbi"

Optional nodes:
- Video port for RFBI output
- RFBI controlled peripherals


VENC
----

Required properties:
- compatible: "ti,omap4-venc"
- reg: address and length of the register space
- ti,hwmods: "dss_venc"
- vdda-supply: power supply for DAC

Optional nodes:
- Video port for VENC output

VENC Endpoint required properties:
- ti,invert-polarity: invert the polarity of the video signal
- ti,channels: 1 for composite, 2 for s-video


DSI
---

Required properties:
- compatible: "ti,omap4-dsi"
- reg: addresses and lengths of the register spaces for 'proto', 'phy' and 'pll'
- reg-names: "proto", "phy", "pll"
- interrupts: the DSI interrupt line
- ti,hwmods: "dss_dsi1" or "dss_dsi2"
- vdd-supply: power supply for DSI

Optional nodes:
- Video port for DSI output
- DSI controlled peripherals

DSI Endpoint required properties:
- lanes: list of pin numbers for the DSI lanes: CLK+, CLK-, DATA0+, DATA0-,
  DATA1+, DATA1-, ...


HDMI
----

Required properties:
- compatible: "ti,omap4-hdmi"
- reg: addresses and lengths of the register spaces for 'wp', 'pll', 'phy',
       'core'
- reg-names: "wp", "pll", "phy", "core"
- interrupts: the HDMI interrupt line
- ti,hwmods: "dss_hdmi"
- vdda-supply: vdda power supply

Optional nodes:
- Video port for HDMI output
```

## Documentation/devicetree/bindings/video/video-ports.txt
```
Video Ports
===========

The video port bindings used for display devices is a superset of the v4l2 video
ports described here:

Documentation/devicetree/bindings/media/video-interfaces.txt

The only difference is a more compact way to describe devices with only one
endpoint. In cases like that, the 'ports' and 'port' nodes are not needed. For
example, a DPI panel with a single input endpoint:

lcd0: display@0 {
	compatible = "samsung,lte430wq-f0c", "panel-dpi";

	lcd_in: endpoint {
		remote-endpoint = <&dpi_out>;
	};
};

The rest of the bindings are the same as in v4l2 video port bindings and not
described here.
```
