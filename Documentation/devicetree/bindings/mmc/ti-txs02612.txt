## Documentation/devicetree/bindings/mmc/ti-txs02612.txt
```
txs02612 SDIO switch

If a txs02612 SDIO switch (and level shifter) is connected
to a sdio/mmc port of a SoC we have effectively two interfaces
as a result. The switch is controlled by a GPIO.

Required properties:

	compatible = “ti,txs02612”

	select-gpio:	the channel select gpio.

	ports:	two new mmc ports.

Optional properties:

	mmc:	phandle to reference the sdio/mmc port of the SoC.
		If the node is a subnode of the mmc port of the SoC
		this phandle can be omitted.

Example:

	mmc-expander {
		compatible = “ti,txs02612”;
		mmc = <&mmc1>;
		select-gpio = <&gpio3 18 0>;	/* GPIO3_82 */
		ports {
			eMMC: port@0 {
				reg = <0>;
				bus-width: 8;
			};
			uSD: port@1 {
				reg = <1>;
				bus-width: 4;
			};
	};
```

## Documentation/devicetree/bindings/nvmem/ingenic,jz4780-efuse.txt
```
Ingenic JZ EFUSE driver bindings

Required properties:
- "compatible"		Must be set to "ingenic,jz4780-efuse"
- "reg"			Register location and length
- "clocks"		Handle for the ahb clock for the efuse.
- "clock-names"		Must be "bus_clk"

Example:

efuse: efuse@134100d0 {
	compatible = "ingenic,jz4780-efuse";
	reg = <0x134100d0 0x2c>;

	clocks = <&cgu JZ4780_CLK_AHB2>;
	clock-names = "bus_clk";
};
```

## Documentation/devicetree/bindings/power/coproc/ti-coproc.txt
```
Texas Instruments co-processor driver

A co-processor device is a non-cpu processor found on an SoC.

This document describes the clock and voltage configuration
used by co-processors/devices typically found on Texas Instrument SoCs.

Required properties
- compatible: should be
	"ti,coproc"
- clocks: <functional clock>, <dpll clock>
	dpll clock is optional
- clock-names: "fclk", "dpll"
	if you change names here, go chnage the driver too
- clock-target-frequency: Mention your target frequency here
- operating-points: all OPPs applicable for this device/coprocessor
- coproc-voltdm: phandle of the Voltage domain associated with this device/coproc
- voltage-tolerance: Specify a voltage tolerance allowed for this voltage domain
as per datamanual limits

Example:
iva_coproc {
	compatible = "ti,coproc";
	clocks = <&dpll_iva_m2_ck>, <&dpll_iva_ck>;
	clock-names = "fclk", "dpll";
	clock-target-frequency = <532000000>;
	operating-points = <
		388200  1055000
		430000	1150000
		532000  1250000
		>;
	coproc-voltdm = <&voltdm_ivahd>;
	voltage-tolerance = <1>;
};
```

## Documentation/devicetree/bindings/power/omap-core-dvfs.txt
```
Core dynamic voltage and frequency scaling driver for Texas Instruments OMAP SoC
It allows to save power during active system state by changing core voltage and
frequency based on CPU performance.

Required Properties:
- compatible: Should be "ti,omap-core-dvfs"
- l3_clkname: An clock name of core L3 interconnect clock
- dpll_clkname: An clock name of DPLL output clock
- core_dvfs-supply: An reference node of core voltage regulator
- operating-points: An array of 2-tuples items, and each item consists
    of frequency and voltage like <freq-kHz vol-uV>. Physical frequency value
    my be different from value in this array becasue of rounding to closest
    possible value based on integer divider. For example if DPLL output clock
    value is 332Mhz and value in array is 200Mhz then physical frequency will
    be 166Mhz because divider is integer. You have to use frequency values,
    which are multiple of DPLL output frequency to avoid rounding.
- map: An array of 2-tuples items, and each item consists
    of CPU frequency and matching core frequency in kHz.
    CPU frequency values should be used from CPU operating-points array

Optional Properties:
- voltage-tolerance: percent value, which voltage in operating-points array
    may deviate from its value

Example:
	dvfs {
		compatible = "simple-bus";

		core_dvfs: core_dvfs {
			compatible = "ti,omap-core-dvfs";

			l3_clkname = "l3_ick";
			dpll_clkname = "dpll3_m2_ck";
			core_dvfs-supply = <&omap_tps65912_dcdc4>;

			operating-points = <
				/* kHz    uV */
				100000   950000
				200000  1150000
			>;
			map = <
				/* cpu freq, core freq*/
				300000 100000
				600000 200000
				800000 200000
			>;
		};
	};
```

## Documentation/devicetree/bindings/power/supply/bq2429x.txt
```
Binding for TI bq24296/24297 Li-Ion Charger

This driver will support the bq24297. It was derived
from a bq2426 driver but is tested with bq24297 only.
There are other ICs in the same family but those have
not been tested.

Required properties:
- compatible: Should contain one of the following:
    * "ti,bq24296"
    * "ti,bq24297"
    * "mps,mp2624"
- reg: integer, i2c address of the device (should be 0x6b).
- regulators: child node defining exactly two regulators for
	1. vsys (battery or usb -> system output) and
	2. otg (battery -> usb).

Optional properties:
- monitored-battery: phandle of the battery
  properties used if defined:
  * voltage-max-design-microvolt (default 4.2V)
  * constant-charge-current-max-microamp (default as defined by boot loader)
- dc-det: gpio for detecting two different DC sources
- ti,usb-input-current-microamp: default current for USB source
- ti,adp-input-current-microamp: default current for other source

Example:

bat: battery {
	compatible = "simple-battery", "pyra-battery";
	voltage-min-design-microvolt = <3200000>;
	voltage-max-design-microvolt = <4200000>;
	energy-full-design-microwatt-hours = <22200000>;
	charge-full-design-microamp-hours = <6000000>;
	charge-term-current-microamp = <128000>;
	constant-charge-current-max-microamp = <1000000>;
};

bq24297@6b {
	compatible = "ti,bq24297";
	reg = <0x6b>;
	monitored-battery = <&bat>;	// provides max-voltage-by-design
	ti,chg_current = <1000 2000 2000>;      // chg_current (max for the battery), usb_input_current, adp_input_current
	interrupt-parent = <&gpio99>;
	interrupts = <(1*8+3) IRQ_TYPE_EDGE_FALLING>;   // P13
	ti,watchdog = <40>;             // 40 seconds watchdog timer
	regulators {
		vsys_reg: vsys_regulator {
			regulator-compatible = "bq2429x-vsys";
			regulator-name = "vsys";
			regulator-min-microvolt = <3500000>;
			regulator-max-microvolt = <4200000>;
			regulator-always-on;
			regulator-boot-on;
		};
		otg_reg: otg_regulator {
			regulator-compatible = "bq2429x-otg";
			regulator-name = "otg";
			regulator-min-microvolt = <4900000>;
			regulator-max-microvolt = <5100000>;
		};
	};
};
```

## Documentation/devicetree/bindings/power/supply/bq2429x.yaml
```yaml
# SPDX-License-Identifier: GPL-2.0
%YAML 1.2
---
$id: http://devicetree.org/schemas/power/supply/bq2429x.yaml#
$schema: http://devicetree.org/meta-schemas/core.yaml#

title: TI bq24296/24297 and MPS MP2624 Li-Ion Charger

maintainers:
  - H. Nikolaus Schaller <hns@goldelico.com>

description: |+
  This binding will support the bq24296 and 297. It was derived
  from a bq24296 driver but is tested with bq24297 only.
  There are other ICs in the same family but those have
  not been tested.
  The MP2624 is very similar to the bq24297 but not exactly
  identical.

properties:
  compatible:
    enum:
      - mps,mp2624
      - ti,bq24296
      - ti,bq24297

  reg:
    const: 0x6b

  interrupts:
    minItems: 1

  monitored-battery:
    description: phandle to the battery node
    allOf:
      - $ref: /schemas/types.yaml#/definitions/phandle
# REVISIT: how can we correctly describe that we support only some of the phandle properties?
    enum:
      - voltage-max-design-microvolt:
        - default: 4200000
      - voltage-min-design-microvolt:
        - default: 3200000
      - constant-charge-current-max-microamp:
        - default: as defined by boot loader
      - precharge-current-microamp:
        - default: 128000
      - charge-term-current-microamp:
        - default: 128000

  regulators:
    minItems: 2
    maxItems: 2
    items:
      # can we specify that these are to be regulator nodes?
      - description: |
          two regulator child nodes for
          [0] vsys (battery or usb input -> system output)
          [1] otg (battery input -> usb output).

  dc-det:
    items:
      - description: gpio for detecting two different DC sources
      - default: use usb-input-current-microamp only

  ti,usb-input-current-microamp:
    items:
      - description: default current for USB source
      - default: value as defined by boot loader

  ti,adp-input-current-microamp:
    items:
      - description: default current for other source (dc-det is 1)
      - default: 2048000

required:
  - compatible
  - reg
  - interrupts
  - regulators

examples:
  - |
   #include <dt-bindings/interrupt-controller/irq.h>

   bat: battery {
      compatible = "simple-battery", "pyra-battery";
      voltage-min-design-microvolt = <3200000>;
      voltage-max-design-microvolt = <4200000>;
      energy-full-design-microwatt-hours = <22200000>;
      charge-full-design-microamp-hours = <6000000>;
      charge-term-current-microamp = <128000>;
      constant-charge-current-max-microamp = <1000000>;
    };

    bq24297@6b {
      compatible = "ti,bq24297";
      reg = <0x6b>;
      monitored-battery = <&bat>;
      interrupt-parent = <&gpio99>;
      interrupts = <(1*8+3) IRQ_TYPE_EDGE_FALLING>;   /* P13 */
      regulators {
        vsys_reg: vsys_regulator {
          regulator-compatible = "bq2429x-vsys";
          regulator-name = "vsys";
          regulator-min-microvolt = <3500000>;
          regulator-max-microvolt = <4200000>;
          regulator-always-on;
          regulator-boot-on;
        };
        otg_reg: otg_regulator {
          regulator-compatible = "bq2429x-otg";
          regulator-name = "otg";
          regulator-min-microvolt = <4900000>;
          regulator-max-microvolt = <5100000>;
        };
      };
    };

...
```

## Documentation/devicetree/bindings/power_supply/twl4030_madc_battery.txt
```
twl4030_madc_battery

Required properties:
 - compatible : "ti,twl4030-madc-battery"
 - capacity : battery capacity in uAh
 - charging-calibration-data : list of voltage(mV):level(%) values for charging calibration (see example)
 - discharging-calibration-data : list of voltage(mV):level(%) values for discharging calibration (see example)

Example:
	madc-battery {
		compatible = "ti,twl4030-madc-battery";
		capacity = <1200000>;
		charging-calibration-data = <4200 100 4100 75 4000 55 3900 25 3800 5 3700 2 3600 1 3300 0>;
		discharging-calibration-data = <4200 100 4100 95 4000 70 3800 50 3700 10 3600 5 3300 0>;
	};
```

## Documentation/devicetree/bindings/regulator/pbias-regulator.txt
```
PBIAS internal regulator for SD card dual voltage i/o pads on OMAP SoCs.

Required properties:
- compatible:
  - "ti,pbias-omap" for OMAP2, OMAP3, OMAP4, OMAP5, DRA7

Optional properties:
- Any optional property defined in bindings/regulator/regulator.txt

Example:

		pbias_regulator: pbias_regulator {
			regulator-name = "pbias_mmc_omap4";
			regulator-min-microvolt = <1800000>;
			regulator-max-microvolt = <3000000>;
	};
```

## Documentation/devicetree/bindings/retrode3/retrode3.yaml
```yaml
# dt binding stub

Controller node and client:

retrode3@40000000 {
    compatible = "dragonbox,retrode3-bus";
    reg = <0x40000000 0x1000>;

    children {
        sensor@1000 {
            compatible = "dragonbox,retrode3-client-example";
            reg = <0x1000>;
            /* optional properties */
            retrode3-controller = <&retrode3ctlr>; /* if client is declared elsewhere */
        };

        eeprom@2000 {
            compatible = "dragonbox,retrode3-eeprom";
            reg = <0x2000>;
        };
    };
};
If the controller is a separate node:

retrode3ctlr: retrode3-controller@40000000 {
    compatible = "dragonbox,retrode3-mmio";
    reg = <0x40000000 0x1000>;
};

sensor@0 {
    compatible = "dragonbox,retrode3-client-example";
    retrode3-controller = <&retrode3ctlr>;
    reg = <0x1000>;
};
```

## Documentation/devicetree/bindings/serial/slaves.txt
```
Device-Tree bindings for UART slave devices

A node describing a slave device defines a phandle to reference the UART
the device is connected to. In the (unexpected) case of two or more UARTs
a list of phandles can be specified.

properties:
	- uart: (list of) phandle(s) of UART(s) the device is connected to
	  if it is missing it defaults to a single parent node


examples:

	gps {
		compatible = "wi2wi,w2sg0004";
		uart = <&uart1>;
	};

	&uart2 {
		gps {
			compatible = "wi2wi,w2sg0004";
		};
	};
```

## Documentation/devicetree/bindings/sound/bt_sco.txt
```
Device-Tree bindings for dummy Bluetooth SCO codec

Required properties:
	- compatible: should be "linux,bt-sco-audio".

CODEC output pins:
  * TX

CODEC input pins:
  * RX

Example node:

	bt_sco_audio: bt_sco_audio@0 {
		compatible = "linux,bt-sco-audio";
		status = "okay";
	};
```

## Documentation/devicetree/bindings/sound/codecs.txt
```
Codecs:

Generic properties for any audio codec handled directly by ASoC core.

Optional properties:
- name-prefix		: Name prefix to avoid kcontrol name collisions
			  in cards with multiple instances of the same codec
```

## Documentation/devicetree/bindings/sound/dra7xx-jamr3-card.txt
```
* Texas Instruments DR7XX JAMR3 card

Required properties:
- compatible: "ti,dra7xx-jamr3-snd"
- ti,model: Name of the sound card
- ti,mcasp-controller: phandle for the McASP node
- ti,audio-codec-a: phandle for the analog codec instance A
- ti,audio-codec-b: phandle for the analog codec instance B
- ti,audio-codec-c: phandle for the analog codec instance C
- ti,audio-slots: number of TDM slots
- ti,audio-routing: List of connections between audio components.
  Each entry is a pair of strings, the first being the connection's sink,
  the second being the connection's source.

Optional properties:
- ti,always-on: Keep analog codecs always on to minimize artifacts. Use it
  if power is not a concern.
- clocks : Reference to the master clock
- clock-names : Master clock name e.g. ti,codec-clock
- ti,audio-mclk-freq: MCLK frequency for the analog codec
Note: Must specify a property either "clock-names" with "clock" or directly
      "ti,audio-mclk-freq" in order to get master clock frequency.

Available audio endpoints for the audio-routing table:

Board connectors:
 * JAMR3 Stereo Aux In
 * JAMR3 Mono Mic 1
 * JAMR3 Mono Mic 2
 * JAMR3 Line Out 1
 * JAMR3 Line Out 2
 * JAMR3 Line Out 3

tlv320aic3x pins:
 * LLOUT
 * RLOUT
 * MONO_LOUT
 * HPLOUT
 * HPROUT
 * HPLCOM
 * HPCOM
 * MIC3L
 * MIC3R
 * LINE1L
 * LINE1R
 * LINE2L
 * LINE2R

JAMR3 analog codec pins for instances A, B and C are prefixed with
'J3A', 'J3B' and 'J3C', respectively.

Example:

jamr3_sound {
	compatible = "ti,dra7xx-jamr3-snd";
	ti,model = "DRA7xx-JAMR3";
	ti,always-on;
	clocks = <&atl_clkin1_ck>;
	clock-names = "ti,codec-clock";

	ti,audio-routing =
		"J3A LINE1L",           "JAMR3 Stereo Aux In",
		"J3A LINE1R",           "JAMR3 Stereo Aux In",
		"J3B LINE1L",           "JAMR3 Mono Mic 1",
		"J3B LINE1R",           "JAMR3 Mono Mic 2",
		"JAMR3 Line Out 1",     "J3A LLOUT",
		"JAMR3 Line Out 1",     "J3A RLOUT",
		"JAMR3 Line Out 2",     "J3B LLOUT",
		"JAMR3 Line Out 2",     "J3B RLOUT",
		"JAMR3 Line Out 3",     "J3C LLOUT",
		"JAMR3 Line Out 3",     "J3C RLOUT";

	/* DAI link */
	ti,mcasp-controller = <&mcasp6>;
	ti,audio-codec-a = <&tlv320aic3106a>;
	ti,audio-codec-b = <&tlv320aic3106b>;
	ti,audio-codec-c = <&tlv320aic3106c>;
	ti,audio-slots = <8>;
	ti,audio-mclk-freq = <11289600>;
};
```
