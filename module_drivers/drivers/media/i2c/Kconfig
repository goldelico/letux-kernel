## module_drivers/drivers/tty/serial/Kconfig
```kconfig
config SERIAL_INGENIC_UART
        tristate "ingenic serial port support"
        select SERIAL_CORE
        help
          If you have a machine based on a xbrust mips soc you can
          enable its onboard serial port by enabling this option.

config SERIAL_INGENIC_CONSOLE
        bool "Console on ingenic soc and compatible serial port"
        depends on SERIAL_INGENIC_UART=y
        select SERIAL_CORE_CONSOLE
        help
          If you say Y here, it will be possible to use a serial port as the
          system console (the system console is the device which receives all
          kernel messages and warnings and which allows logins in single user
          mode). This could be useful if some terminal or printer is connected
          to that serial port.

          Even if you say Y here, the currently visible virtual console
          (/dev/tty0) will still be used as the system console by default, but
          you can alter that using a kernel command line option such as
          "console=ttyS1". (Try "man bootparam" or see the documentation of
          your boot loader (grub or lilo or loadlin) about how to pass options
          to the kernel at boot time.)

          If you don't have a VGA card installed and you say Y here, the
          kernel will automatically use the first serial line, /dev/ttyS0, as
          system console.

          If unsure, say N.

config SERIAL_INGENIC_LARGE_BAUDRATE
        bool "ingenic baudrate add support greater than 1M"
        depends on SERIAL_INGENIC_UART=y
        default y

config SERIAL_INGENIC_MAGIC_SYSRQ
        bool "ingenic uart enable Magic SysRq key"
        depends on MAGIC_SYSRQ=y && SERIAL_INGENIC_UART=y
        default n
```
