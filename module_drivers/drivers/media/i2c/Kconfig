## module_drivers/drivers/media/platform/ingenic-rotate/Kconfig
```kconfig
config VIDEO_INGENIC_ROTATE
        depends on VIDEO_DEV && VIDEO_V4L2
        tristate "Ingenic rotate driver"
        select VIDEOBUF2_DMA_CONTIG_INGENIC
        select V4L2_MEM2MEM_DEV
        help
          This is a v4l2 driver for Ingenic rotate
```

## module_drivers/drivers/media/platform/ingenic-vcodec/Kconfig
```kconfig
config VIDEO_INGENIC_VCODEC
        tristate "V4L2 driver for ingenic Video Codec"
        depends on VIDEO_DEV && VIDEO_V4L2
        select V4L2_MEM2MEM_DEV
        select VIDEOBUF2_DMA_CONTIG_INGENIC
        select VIDEOBUF2_DMA_CONTIG

config INGENIC_HELIX
	tristate "[ENC] ingenic video helix"
	depends on VIDEO_INGENIC_VCODEC
config INGENIC_FELIX
	tristate "[DEC] ingenic video felix"
	depends on VIDEO_INGENIC_VCODEC
```

## module_drivers/drivers/media/v4l2-core/Kconfig
```kconfig
config VIDEOBUF2_DMA_CONTIG_INGENIC
        tristate
        depends on HAS_DMA
        select VIDEOBUF2_CORE
        select VIDEOBUF2_MEMOPS
        select DMA_SHARED_BUFFER


config CAMERA_RESERVE_KB_SIZE
        int "Reserve memory for camera noncoherent memory. Unit:KByte"
        default 0
        depends on VIDEOBUF2_DMA_CONTIG_INGENIC
```

## module_drivers/drivers/mfd/Kconfig
```kconfig
config MFD_INGENIC_SADC_V13
	tristate "[SADC] Support for the Ingenic SADC core"
	select MFD_CORE
	depends on MACH_XBURST || MACH_XBURST2
	help
	  Say yes here if you want support for the SADC unit in the Ingenic SoC.
	  This driver is necessary for Ingenic_battery driver.

config MFD_INGENIC_SADC_AUX
	tristate "[SADC] Support for the Ingenic SADC AUX"
	select MFD_CORE
	depends on MACH_XBURST || MACH_XBURST2
	help
	  Say yes here if you want support for the SADC unit in the Ingenic SoC.
	  This driver is necessary for ingenic_battery driver.
if MFD_INGENIC_SADC_AUX
	config SADC_AUX_VERF_3V3
	bool "Ingenic sadc aux reference voltage 3.3V."
	depends on SOC_X1600
	default y
	help
	  Select ingenic sadc reference voltage.

	config SADC_AUX_VERF_1V8
	bool "Ingenic sadc aux reference voltage 1.8V."
	depends on SOC_X2000_V12 || SOC_M300 || SOC_X2100 || SOC_X2500
	default y
	help
	  Select ingenic sadc reference voltage.


	config SADC_AUX_12BIT
	bool "ingenic sadc aux 12bit"
	depends on SOC_X2500 || SOC_X1600
	default y

	config SADC_AUX_10BIT
	bool "ingenic sadc aux 10bit"
	depends on SOC_X2000_V12 || SOC_M300 || SOC_X2100
	default y
endif

config MFD_INGENIC_TCU
	bool "[TCU] Ingenic tcu driver"
	select MFD_CORE
	select GENERIC_IRQ_CHIP
	depends on SOC_X2000_V12 || SOC_X2000 || SOC_M300 || SOC_X2100 || SOC_X1600
	help
	  Say yes here if you want support for the TCU unit in the ingenic SoC.
	  This driver is necessary for ingenic pwm or counter.

config MFD_INGENIC_TCU_V1
	bool "[TCU] Ingenic tcu driver v1"
	select MFD_CORE
	select GENERIC_IRQ_CHIP
	depends on SOC_X2500
	default n
	help
	  Say yes here if you want support for the TCU unit in the ingenic SoC.
	  This driver is necessary for ingenic pwm or counter.


config MFD_RICOH619
	bool "Ricoh RC5T619 Power Management system device"
	depends on I2C=y
	select MFD_CORE
	select REGMAP_I2C
	help
	  Select this option to get support for the RICOH619 Power
	  Management system device.
	  This driver provides common support for accessing the device
	  through i2c interface. The device supports multiple sub-devices
	  like GPIO, interrupts, RTC, LDO and DCDC regulators, onkey.
	  Additional drivers must be enabled in order to use the
	  different functionality of the device.
```

## module_drivers/drivers/misc/Kconfig
```kconfig
config INGENIC_RSA
        bool "[RSA] JZ RSA Driver"
        depends on SOC_X2000 || SOC_X2100 || SOC_M300 || SOC_X2500
        help
                this driver is used to Encrypt/Decrypt by RSA.
        default n

config LINUX_PMEM
        bool "Linux pmem allocator"
        default n

config PMEM_RESERVE_SIZE
        string "reserve size"
        depends on LINUX_PMEM
        default 0M
        help
                set this like 16M, 4096K, 100000[B], 0x5000(B).

config INGENIC_EFUSE_V2
          bool "[Efuse] Ingenic Efuse v2 Driver"
          depends on SOC_X1600
          default n

config INGENIC_EFUSE_V2_WRITABLE
        bool "[Efuse] Ingenic Efuse V2 Writable"
	depends on INGENIC_EFUSE_V2
        default n


config INGENIC_EFUSE_X2000
          bool "[Efuse] Ingenic Efuse X2000 Driver"
	  	  depends on SOC_X2000 || SOC_X2100 || SOC_M300
          default n

config BCM_4345C5_RFKILL
	tristate "Bluetooth power control driver for BCM-4345C5 module"
	depends on RFKILL && (MMC_SDHCI_INGENIC || INGENIC_MMC_MMC0 || INGENIC_MMC_MMC1)
	default n
	help
	Creates an rfkill entry in sysfs for power control of Bluetooth
	bcm-xxxx chips.
```

## module_drivers/drivers/mmc/host/Kconfig
```kconfig
config MMC_SDHCI_INGENIC
        tristate "Ingenic(XBurst2)  MMC/SD Card Controller(MSC) support"
	depends on SOC_X2000 || SOC_X2000_V12 || SOC_M300 || SOC_X2500 || SOC_X2100
        select MMC_SDHCI
        help
          This selects the Ingenic XBurst2 SD/MMC Card Controller MSC.
          If you have platform with a SD/Multimedia Card slot and compact
          with this version, say Y or M here.
          If unsure, say N.

config MMC_INDEX_MATCH_CONTROLLER
        tristate "MMC Index match Controller support."
        depends on MMC_SDHCI_INGENIC || INGENIC_MMC
        default n
        help
          This selects the MMC Index match Controller support.This option
          will enable MMC index to match the controller number. If you want
          mmcblk to correspond to the controller number,say Y or M here.

          If unsure, say N.


 config INGENIC_MMC
         tristate "Ingenic(XBurst)  MMC/SD Card Controller(MSC) support"
         depends on SOC_X1600 || SOC_X1000 || SOC_X1800 || SOC_X1021 || SOC_X1520 || SOC_X1630
         help
           This selects the Ingenic XBurst SD/MMC Card Controller.
           If you have platform with a SD/Multimedia Card slot and compact
           with this version, say Y or M here.
           If unsure, say N.

 config INGENIC_MMC_MMC0
         bool "INGENIC_MMC MMC0"
         depends on INGENIC_MMC

 config INGENIC_MMC_MMC1
         bool "INGENIC_MMC MMC1"
         depends on INGENIC_MMC
```

## module_drivers/drivers/mtd/devices/Kconfig
```kconfig
config INGENIC_SFC
	tristate "Ingenic series SFC driver"
	depends on MACH_XBURST || MACH_XBURST2
	help
		SFC driver for Ingenic series SoCs

if INGENIC_SFC


choice
	prompt "Select Ingenic series SFC driver version"
	default MTD_INGENIC_SFC_V1
	help
	  Select the SFC driver version

config MTD_INGENIC_SFC_V1
	bool "Use ingenic sfc driver version 1"
	depends on INGENIC_SFC

config MTD_INGENIC_SFC_V2
	bool "Use ingenic sfc driver version 2"
	depends on INGENIC_SFC

endchoice


choice
	prompt "the SFC external memory (nor or nand)"
	help
	  Select the SFC external memory

config MTD_INGENIC_SFC_NORFLASH
	bool "Support ingenic sfc-nor"
	depends on INGENIC_SFC

config MTD_INGENIC_SFC_NANDFLASH
	bool "Support ingenic sfc-nand"
	depends on INGENIC_SFC
	select MTD_NAND

endchoice


config INGENIC_SFCNAND_FMW
	bool "ingenic SN and MAC read write support."
	default n
	depends on INGENIC_SFC && MTD_INGENIC_SFC_NANDFLASH
	help
		Say Y here if you want to use sn read write function. when in doubt , Say N here.

config SN_SIZE
	int "SN space size (MB)"
	range 1 5
	default 1
	depends on INGENIC_SFCNAND_FMW

config MAC_SIZE
	int "MAC space size (MB)"
	range 1 5
	default 1
	depends on INGENIC_SFCNAND_FMW

config LICENSE_SIZE
	int "LICENSE space size (MB)"
	range 1 5
	default 1
	depends on INGENIC_SFCNAND_FMW


menuconfig INGENIC_BUILTIN_PARAMS
	bool "Use SPI Nor Flash params built in kernel"
	depends on MTD_INGENIC_SFC_NORFLASH
	default n
	help
		Say Y here to SPI Nor Flash params built in kernel.

config INGENIC_GD25Q127C
	bool "GD25Q127C 0xc84018"
	depends on INGENIC_BUILTIN_PARAMS

config INGENIC_GD25Q256C
	bool "GD25Q256C 0xc84019"
	depends on INGENIC_BUILTIN_PARAMS

config INGENIC_GD25S512MD
	bool "GD25S512MD 0xc84019"
	depends on INGENIC_BUILTIN_PARAMS


endif
```

## module_drivers/drivers/net/ethernet/ingenic/Kconfig
```kconfig
config INGENIC_MAC
	tristate "ingenic on-chip MAC support"
	select CRC32
	select MII
	help
	  This is the driver for INGENIC on-chip mac device.

config INGENIC_MAC_DMA_INTERFACES
	bool "Ingenic mac dma interfaces"
	depends on INGENIC_MAC
	help
	  This is for MAC Dma interfaces selection
choice
	prompt "Ingenic mac dma bus interfaces"
	depends on INGENIC_MAC_DMA_INTERFACES

config INGENIC_MAC_AXI_BUS
	bool "MAC_AXI_BUS"
	help
	  Select for mac dma AXI bus

config INGENIC_MAC_AHB_BUS
	bool "MAC_AHB_BUS"
	help
	  Select for mac dma AHB bus
endchoice

config INGENIC_GMAC_USE_HWSTAMP
    bool "Use IEEE 1588 hwstamp"
	depends on INGENIC_MAC
	select PTP_1588_CLOCK
	help
	  To support the IEEE 1588 Precision Time Protocol (PTP)

config INGENIC_GMAC_MUTUAL_TRANS
    bool "Dual core mutex transmission"
	depends on INGENIC_MAC
	help
	  Dual core mutex transmission for cache bumps

config INGENIC_GMAC_RX_DESC_COUNT
    int "Ingenic gmac receive descriptor number[80..10240]"
	depends on INGENIC_MAC
        default 512
	help
	  Ingenic gmac receive descriptor number
```

## module_drivers/drivers/net/wireless/Kconfig
```kconfig
source "module_drivers/drivers/net/wireless/bcmdhd/Kconfig"
#source "module_drivers/drivers/net/wireless/realtek/rtl8723ds/Kconfig"
```

## module_drivers/drivers/net/wireless/bcmdhd_1_363_125_17/Kconfig
```kconfig
config BCMDHD_1_363_125_17
	tristate "Broadcom FullMAC wireless cards support ver:1.363.125.17"
	help
	  This module adds support for wireless adapters based on
	  Broadcom FullMAC chipset.

	  If you choose to build a module, it'll be called dhd. Say M if
	  unsure.

config BCMDHD_1_363_125_17_SDIO
	bool "SDIO bus interface support"
	depends on BCMDHD_1_363_125_17 && MMC

config BCMDHD_1_363_125_17_PCIE
	bool "PCIe bus interface support"
	depends on BCMDHD_1_363_125_17 && PCI && !BCMDHD_1_363_125_17_SDIO

config BCM4354
	tristate "BCM4354 support"
	depends on BCMDHD_1_363_125_17

config BCM4356
	tristate "BCM4356 support"
	depends on BCMDHD_1_363_125_17
	default n

config BCMDHD_1_363_125_17_FW_PATH
	depends on BCMDHD_1_363_125_17
	string "Firmware path"
	default "/system/vendor/firmware/fw_bcmdhd.bin"
	help
	  Path to the firmware file.

config BCMDHD_1_363_125_17_NVRAM_PATH
	depends on BCMDHD_1_363_125_17
	string "NVRAM path"
	default "/system/etc/wifi/bcmdhd.cal"
	help
	  Path to the calibration file.

config BCMDHD_1_363_125_17_WEXT
	bool "Enable WEXT support"
	depends on BCMDHD_1_363_125_17 && CFG80211 = n
	select WIRELESS_EXT
	select WEXT_PRIV
	help
	  Enables WEXT support

config DHD_USE_STATIC_BUF
	bool "Enable memory preallocation"
	depends on BCMDHD_1_363_125_17
	default n
	help
	  Use memory preallocated in platform

config DHD_USE_SCHED_SCAN
	bool "Use CFG80211 sched scan"
	depends on BCMDHD_1_363_125_17 && CFG80211
	default n
	help
	  Use CFG80211 sched scan

config DHD_SET_RANDOM_MAC_VAL
hex "Vendor OUI"
depends on BCMDHD_1_363_125_17
default 0x001A11
 help
Set vendor OUI for SoftAP
```

## module_drivers/drivers/pinctrl/Kconfig
```kconfig
config PINCTRL_INGENIC_V2
	bool "Pinctrl driver for the Ingenic X2000/X1600 SoCs"
	default y
	depends on OF
	depends on MIPS || COMPILE_TEST
	select GENERIC_PINCONF
	select GENERIC_PINCTRL_GROUPS
	select GENERIC_PINMUX_FUNCTIONS
	select GPIOLIB
	select GPIOLIB_IRQCHIP
	select REGMAP_MMIO

config MULTI_VGPIO_INGENIC
	   bool "multiple input lineout to signle output"
```

## module_drivers/drivers/power/supply/axp_power/Kconfig
```kconfig
menuconfig KP_AXP
	bool "AXP Power drivers"
	depends on REGULATOR
	default n
	help
	  This option allows you to select AXP power driver

if KP_AXP

choice
	prompt "AXP PMU type"
	default AXP216

config AXP216
	bool "AXP216 driver"
	help
	  AXP216 driver

endchoice

config AXP_DEBUG
	bool "AXP debug interface"
	default n

config KP_OUTPUTINIT
	bool "AXP output init"
	default n

config AXP_CHARGEINIT
	bool "AXP initial charging environment set"
	default y

config AXP_CHGCHANGE
	bool "AXP charging current set when suspend\resume\shutdown"
	default y

endif # !KP_AXP
```

## module_drivers/drivers/pwm/Kconfig
```kconfig
config PWM_INGENIC
        tristate "Ingenic PWM support"
        depends on MACH_XBURST || SOC_X2500
        help
          Generic PWM framework driver for Ingenic soc based
          machines.

          To compile this driver as a module, choose M here: the module
          will be called pwm-ingenic.

config PWM_INGENIC_V2
        tristate "Ingenic PWM V2 support"
        depends on SOC_X2000_V12 || SOC_X2000 || SOC_M300 || SOC_X2100
        help
          Generic PWM framework driver for Ingenic soc based
          machines.
          Support SOCs: X2000,

          To compile this driver as a module, choose M here: the module
          will be called pwm-ingenic.


config PWM_INGENIC_V3
        bool "Ingenic V3 PWM support"
        depends on SOC_X1600
        help
          Generic PWM framework driver for ingenic PWM-V3
          machines.

config JZ_PWM_GPIO_TRIGGER
        bool "pwm gpio trigger support"
        depends on PWM_INGENIC_V3
        default n
```

## module_drivers/drivers/rtc/Kconfig
```kconfig
config RTC_DRV_INGENIC
    tristate "INGENIC RTC"
            help
            If you say Y here you will get access to the real time clock
              built into your INGENIC CPU.

              To compile this driver as a module, choose M here: the
	      module will be called rtc-ingenic.

config SUSPEND_TEST
	  bool "Ingenic RTC suspend test"
	  depends on RTC_DRV_INGENIC
	  help
	  If you say yes here the Ingenic rtc will support suspend test.

config SUSPEND_ALARM_TIME
	  int "Ingenic RTC suspend alarm time Unit of second"
	  depends on SUSPEND_TEST
	  default "60"
	  help
	  If you say yes here Automatically wake up after a set time of sleep.
```

## module_drivers/drivers/spi/Kconfig
```kconfig
config INGENIC_SPI
        tristate "Ingenic SPI Controller"
        depends on (MACH_XBURST || MACH_XBURST2)
        select SPI_BITBANG
        help
                SPI driver for Ingenic series SoCs

config INGENIC_SPI0
    bool "Ingenic SoC SSI controller 0 for SPI Host driver"
        depends on INGENIC_SPI

config INGENIC_SPI_PIO_CE
        bool "Use GPIO CE on Ingenic SSI controller 0"
        depends on INGENIC_SPI
        default n
        help
                Use GPIO control SSI CE by CPU. Sometimes controller's CE NOT match SPI Protocal
config INGENIC_SLV
        tristate "Ingenic series SPI slave driver"
        depends on MACH_XBURST
        select SPI_BITBANG
        help
                SPI slave driver for Ingenic JZ series SoCs
config INGENIC_SLV0
        bool "Ingenic SoC SSI_SLV controller 0 for SPI SLV Host driver"
        depends on INGENIC_SLV
```
