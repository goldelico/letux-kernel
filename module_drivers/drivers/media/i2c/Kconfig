## module_drivers/drivers/media/i2c/Kconfig
```kconfig
source "module_drivers/drivers/media/i2c/ingenic-isp/Kconfig"
source "module_drivers/drivers/media/i2c/ingenic-isp-v2/Kconfig"
source "module_drivers/drivers/media/i2c/ingenic-cim/Kconfig"
```

## module_drivers/drivers/media/i2c/ingenic-cim/Kconfig
```kconfig
comment "ingenic-cim camera sensor drivers"

config INGENIC_CIM_CAMERA_OV2735B
	tristate "ov2735 camera DVP interface support"
	depends on VIDEO_INGENIC_CIM && I2C
	help
	  This is a ingenic-cim camera driver for the OmniVision OV2735 sensor DVP interface

config INGENIC_CIM_CAMERA_AR0144
	tristate "ar0144 camera mipi interface support"
	depends on VIDEO_INGENIC_CIM && I2C
	help
	  This is a ingenic-cim camera driver for the OmniVision AR0144 sensor MIPI interface

config INGENIC_CIM_CAMERA_OV5640
	tristate "ov5640 camera DVP interface support"
	depends on VIDEO_INGENIC_CIM && I2C
	help
	  This is a ingenic-cim camera driver for the OmniVision OV5640 sensor DVP interface

config INGENIC_CIM_CAMERA_SC031GS
	tristate "sc031gs camera DVP interface support"
	depends on VIDEO_INGENIC_CIM && I2C
	help
	  This is a ingenic-cim camera driver for the OmniVision SC031GS sensor DVP interface

config INGENIC_CIM_CAMERA_MIPI_SC031GS
	tristate "sc031gs camera mipi interface support"
	depends on VIDEO_INGENIC_CIM && I2C
	help
	  This is a ingenic-cim camera driver for the OmniVision SC031GS sensor MIPI interface

config INGENIC_CIM_CAMERA_OV5645
	tristate "ov5645 camera mipi interface support"
	depends on VIDEO_INGENIC_CIM && I2C
	help
	  This is a ingenic-cim camera driver for the OmniVision OV5645 sensor MIPI interface

config INGENIC_CIM_CAMERA_OV9281
	tristate "ov9281 camera mipi interface support"
	depends on VIDEO_INGENIC_CIM && I2C
	help
	  This is a ingenic-cim camera driver for the OmniVision OV9281 sensor MIPI interface

config INGENIC_CIM_CAMERA_OV9281_DVP_SNAPSHOT
	tristate "ov9281 camera support cim snapshot"
	depends on VIDEO_INGENIC_CIM && I2C
	help
	  This is a ingenic-cim camera driver for the OmniVision OV9281 sensor DVP interface

config INGENIC_CIM_CAMERA_OV4689
	tristate "ov4689 camera mipi interface support"
	depends on VIDEO_INGENIC_CIM && I2C
	help
	  This is a ingenic-cim camera driver for the OmniVision OV4689 sensor MIPI interface
```

## module_drivers/drivers/media/i2c/ingenic-isp-v2/Kconfig
```kconfig
comment "ingenic-isp-v2 camera sensor drivers"

config INGENIC_ISP_V2_CAMERA_IMX327
	tristate "imx327 sensor support"
	depends on VIDEO_INGENIC_ISP_V2 && I2C
	help
	  This is a ingenic-isp camera driver for IMX327

config INGENIC_ISP_V2_CAMERA_GC2093
	tristate "gc2093 sensor support"
	depends on VIDEO_INGENIC_ISP_V2 && I2C
	help
	  This is a ingenic-isp camera driver for GC2093

config INGENIC_ISP_V2_CAMERA_OV2735A
	tristate "ov2735a sensor support"
	depends on VIDEO_INGENIC_ISP_V2 && I2C
	help
	  This is a ingenic-isp camera driver for ov2735a

config INGENIC_ISP_V2_CAMERA_SC2310
	tristate "sc2310 sensor support"
	depends on VIDEO_INGENIC_ISP_V2 && I2C
	help
	  This is a ingenic-isp camera driver for sc2310

config INGENIC_ISP_V2_CAMERA_SC230AI
	tristate "sc230ai sensor support"
	depends on VIDEO_INGENIC_ISP_V2 && I2C
	help
	  This is a ingenic-isp camera driver for sc230ai

config INGENIC_ISP_V2_CAMERA_GC2155
	tristate "gc2155 sensor support"
	depends on VIDEO_INGENIC_ISP_V2 && I2C
	help
	  This is a ingenic-isp camera driver for gc2155

config INGENIC_ISP_V2_CAMERA_OV4689
	tristate "ov4689 sensor support"
	depends on VIDEO_INGENIC_ISP_V2 && I2C
	help
	  This is a ingenic-isp camera driver for ov4689

config INGENIC_ISP_V2_CAMERA_OV7251
	tristate "ov7251 sensor support"
	depends on VIDEO_INGENIC_ISP_V2 && I2C
	help
	  This is a ingenic-isp camera driver for ov7251
```

## module_drivers/drivers/media/i2c/ingenic-isp/Kconfig
```kconfig
comment "ingenic-isp camera sensor drivers"


config INGENIC_ISP_CAMERA_OV4689
	tristate "ov4689 camera support"
	depends on VIDEO_INGENIC_ISP && I2C
	help
	  This is a ingenic-isp camera driver for the OmniVision OV4689 sensor

config INGENIC_ISP_CAMERA_SC2232H
	tristate "sc2232h camera support"
	depends on VIDEO_INGENIC_ISP && I2C
	help
	  This is a ingenic-isp camera driver for the OmniVision sc2232h sensor

config INGENIC_ISP_CAMERA_OV2735B
	tristate "ov2735 camera DVP interface support"
	depends on VIDEO_INGENIC_ISP && I2C
	help
	  This is a ingenic-isp camera driver for the OmniVision OV2735 sensor DVP interface

config INGENIC_ISP_CAMERA_OV2735A
	tristate "ov2735 camera MIPI interface support"
	depends on VIDEO_INGENIC_ISP && I2C
	help
	  This is a ingenic-isp camera driver for the OmniVision OV2735 sensor MIPI interface

config INGENIC_ISP_CAMERA_GC1054
	tristate "gc1054 camera MIPI interface support"
	depends on VIDEO_INGENIC_ISP && I2C
	help
	  This is a ingenic-isp camera driver for the Galaxyc gc1054 sensor MIPI interface

config INGENIC_ISP_CAMERA_AR0144
	tristate "ar0144 camera support"
	depends on VIDEO_INGENIC_ISP && I2C
	help
	  This is a ingenic-isp camera driver for the Onsemi ar0144 sensor

config INGENIC_ISP_CAMERA_AR0234
	tristate "ar0234 camera support"
	depends on VIDEO_INGENIC_ISP && I2C
	help
	  This is a ingenic-isp camera driver for the Onsemi ar0234 sensor

config INGENIC_ISP_CAMERA_OV7251
	tristate "ov7251 camera MIPI interface support"
	depends on VIDEO_INGENIC_ISP && I2C
	help
	  This is a ingenic-isp camera driver for the OmniVision OV7251 sensor MIPI interface

config INGENIC_ISP_CAMERA_SC031GS
	tristate "sc031gs camera MIPI interface support"
	depends on VIDEO_INGENIC_ISP && I2C
	help
	  This is a ingenic-isp camera driver for the SmartSens sc031gs sensor MIPI interface

config INGENIC_ISP_CAMERA_OV6710
	tristate "ov6710 camera MIPI interface support"
	depends on VIDEO_INGENIC_ISP && I2C
	help
	  This is a ingenic-isp camera driver for the OmniVision OV6710 sensor MIPI interface

config INGENIC_ISP_CAMERA_CISADC
	tristate "CIS ADC Simulator"
	depends on VIDEO_INGENIC_ISP && I2C
	help
	  This is a ingenic-isp camera driver for CIS ADC

config INGENIC_ISP_CAMERA_GC2093
	tristate "gc2093 camera MIPI interface support"
	depends on VIDEO_INGENIC_ISP && I2C
	help
	  This is a ingenic-isp camera driver for the OmniVision GC2093 sensor MIPI interface

config INGENIC_ISP_CAMERA_GM8914_GM8913_GC2093
	tristate "GM8914 GM8913 gc2093 camera support"
	depends on VIDEO_INGENIC_ISP && I2C
	help
	  This is a ingenic-isp camera driver for the zhenxin gm8914/gm8913 gc2093 sensor

config INGENIC_ISP_CAMERA_IMX335
	tristate "IMX335 camera MIPI interface support"
	depends on VIDEO_INGENIC_ISP && I2C
	help
	  This is a ingenic-isp camera driver for IMX335 sensor MIPI interface

config INGENIC_ISP_CAMERA_SC230AI
	tristate "SC230AI camera MIPI interface support"
	depends on VIDEO_INGENIC_ISP && I2C
	help
	  This is a ingenic-isp camera driver for SC230AI sensor MIPI interface
```

## module_drivers/drivers/media/platform/Kconfig
```kconfig
menu "[ISP] Drivers"


config VIDEO_INGENIC_ISP
        tristate "V4L2 Driver for ingenic isp"
        depends on VIDEO_DEV && VIDEO_V4L2
	depends on SOC_X2000_V12 || SOC_X2000 || SOC_M300 || SOC_X2100
        select VIDEOBUF2_DMA_CONTIG
        select VIDEOBUF2_DMA_CONTIG_INGENIC
source "module_drivers/drivers/media/platform/ingenic-isp/Kconfig"


config VIDEO_INGENIC_ISP_V2
        tristate "V4L2 Driver for ingenic isp version 2"
        depends on VIDEO_DEV && VIDEO_V4L2
	depends on SOC_X2500
        select VIDEOBUF2_DMA_CONTIG
        select VIDEOBUF2_DMA_CONTIG_INGENIC
source "module_drivers/drivers/media/platform/ingenic-isp-v2/Kconfig"
endmenu

menu "[CIM] Drivers"
	depends on SOC_X2000_V12 || SOC_X2000 || SOC_M300 || SOC_X1600 || SOC_X2100
source "module_drivers/drivers/media/platform/ingenic-cim/Kconfig"
endmenu


menu "[Rotator] Drivers"
	depends on SOC_X2000_V12 || SOC_X2000 || SOC_M300 || SOC_X2100
source "module_drivers/drivers/media/platform/ingenic-rotate/Kconfig"
endmenu

menu "[I2D] Drivers"
	depends on SOC_X2500
source "module_drivers/drivers/media/platform/ingenic-i2d/Kconfig"
endmenu

menu "[VPU] Drivers"
	depends on SOC_X2000_V12 || SOC_X2000 || SOC_M300 || SOC_X2100
source "module_drivers/drivers/media/platform/ingenic-vcodec/Kconfig"
endmenu
```

## module_drivers/drivers/media/platform/ingenic-cim/Kconfig
```kconfig
config VIDEO_INGENIC_CIM
	tristate "Ingenic Soc Camera Driver for X2000 && M300 && X1600"
	select VIDEOBUF2_DMA_CONTIG_INGENIC
	select V4L2_FWNODE
	help
		CIM Driver for X2000 && M300 && X1600

config CAMERA_USE_SNAPSHOT
	bool "Sensor support snapshot function"
	depends on VIDEO_INGENIC_CIM
	help
		Sensor support snapshot function

config SNAPSHOT_PULSE_WIDTH
        int "Snapshot pulse width"
        depends on CAMERA_USE_SNAPSHOT
        default 8
        help
          Snapshot pulse width

config SNAPSHOT_FRAME_DELAY
        int "One frame end delay"
        depends on CAMERA_USE_SNAPSHOT
        default 100
        help
          One frame end delay

menuconfig PANDA_CAMERA_BOARD
	bool "panda_camera_board"
	depends on VIDEO_INGENIC_CIM
	depends on SOC_X1600
	default n
	help
	  Say Y here to enable support for panda_camera_boards.

config RD_X1600_PANDA_MIPI_CAMERA_1V0
	bool "panda camera driver for RD_X1600_PANDA_MIPI_CAMERA_1V0"
	depends on PANDA_CAMERA_BOARD
	select INGENIC_CIM_CAMERA_OV5645

config RD_X1600_PANDA_MIPI_CAMERA_2V0
	bool "panda camera driver for RD_X1600_PANDA_MIPI_CAMERA_2V0"
	depends on PANDA_CAMERA_BOARD
	select INGENIC_CIM_CAMERA_OV9281

config RD_X1600_PANDA_MIPI_CAMERA_3V2
	bool "panda camera driver for RD_X1600_PANDA_MIPI_CAMERA_3V2"
	depends on PANDA_CAMERA_BOARD
	select INGENIC_CIM_CAMERA_OV4689

config RD_X1600_PANDA_DVP_CAMERA_1V0
	bool "panda camera driver for RD_X1600_PANDA_DVP_CAMERA_V1.0"
	depends on PANDA_CAMERA_BOARD
	select INGENIC_CIM_CAMERA_SC031GS

config RD_X1600_PANDA_DVP_CAMERA_AND_LCD_1V0
	bool "panda camera driver for RD_X1600_PANDA_DVP_CAMERA_AND_LCD_V1.0"
	depends on PANDA_CAMERA_BOARD
	select INGENIC_CIM_CAMERA_OV5640

config RD_X1600_PANDA_DVP_CAMERA_2V0
	bool "panda camera driver for RD_X1600_PANDA_DVP_CAMERA_V2.0"
	depends on PANDA_CAMERA_BOARD
	select INGENIC_CIM_CAMERA_OV9281_DVP_SNAPSHOT

menuconfig HALLEY6_CAMERA_BOARD
	bool "halley6_camera_board"
	depends on VIDEO_INGENIC_CIM
	depends on SOC_X1600
	default n
	help
	  Say Y here to enable support for panda_camera_boards.

config RD_X1600_HALLEY6_MIPI_CAMERA
	bool "halley6 camera driver for RD_X1600_HALLEY6_MIPI_CAMERA"
	depends on HALLEY6_CAMERA_BOARD
	select INGENIC_CIM_CAMERA_MIPI_SC031GS

config RD_X1600_HALLEY6_DVP_CAMERA
	bool "halley6 camera driver for RD_X1600_HALLEY6_DVP_CAMERA"
	depends on HALLEY6_CAMERA_BOARD
	select INGENIC_CIM_CAMERA_SC031GS
```

## module_drivers/drivers/media/platform/ingenic-i2d/Kconfig
```kconfig
menuconfig JZ_I2D
    bool "JZ I2D Driver"
    default n
    depends on SOC_X2500 && VIDEO_DEV && VIDEO_V4L2
    select VIDEOBUF2_DMA_CONTIG_INGENIC
    select V4L2_MEM2MEM_DEV
    help
        Support for Ingenic i2d Driver

config INGENIC_I2D
	tristate "Ingenic I2D Driver"
	depends on JZ_I2D
	default n
	help
	  Support for Ingenic i2d operations (image rotater).
```

## module_drivers/drivers/media/platform/ingenic-isp-v2/Kconfig
```kconfig
choice
	prompt "isp total sensor num select"
	depends on VIDEO_INGENIC_ISP_V2
	default INGENIC_ISP_V2_SENSOR_NUM_TWO
	help
	Select isp total sensor number.
config INGENIC_ISP_V2_SENSOR_NUM_ONE
	bool "isp total sensor num one"
config INGENIC_ISP_V2_SENSOR_NUM_TWO
	bool "isp total sensor num two"
config INGENIC_ISP_V2_SENSOR_NUM_THREE
	bool "isp total sensor num three"
endchoice


menuconfig HIPPO_CAMERA_BOARD
	bool "hippo_camera_board"
	depends on VIDEO_INGENIC_ISP_V2
	default n
	help
		Say Y here to enable support for hippo_camera_boards.


config RD_X2500_HIPPO_CAMERA_1V0
	bool "X2500 isp camera driver for RD_X2500_HIPPO_CAMERA_1V0"
	depends on HIPPO_CAMERA_BOARD
	select INGENIC_ISP_V2_CAMERA_SC230AI
	select INGENIC_ISP_V2_CAMERA_GC2155

config RD_X2500_HIPPO_CAMERA_1V1
	bool "X2500 isp camera driver for RD_X2500_HIPPO_CAMERA_1V1"
	depends on HIPPO_CAMERA_BOARD
	select INGENIC_ISP_V2_CAMERA_SC230AI

config RD_X2000_HALLEY5_CAMERA_3V2
	bool "X2500 isp camera driver for RD_X2000_HALLEY5_CAMERA_3V2"
	depends on HIPPO_CAMERA_BOARD
	select INGENIC_ISP_V2_CAMERA_OV4689

config RD_X2000_HALLEY5_CAMERA_4V3
	bool "X2500 isp camera driver for RD_X2000_HALLEY5_CAMERA_4V3"
	depends on HIPPO_CAMERA_BOARD
	select INGENIC_ISP_V2_CAMERA_OV2735A


config VIC_DMA_ROUTE
	bool "vic dma out route enable"
	default n
	depends on VIDEO_INGENIC_ISP_V2

config MSCA_BDEV
	bool "mscaler bdev support"
	default n
	depends on VIDEO_INGENIC_ISP_V2
```

## module_drivers/drivers/media/platform/ingenic-isp/Kconfig
```kconfig
config VIC_DMA_ROUTE
	bool "vic dma out route enable"
	default n
	depends on VIDEO_INGENIC_ISP

config MSCA_BDEV
	bool "mscaler bdev support"
	default n
	depends on VIDEO_INGENIC_ISP

# halley5 board
menuconfig HALLEY5_CAMERA_BOARD
	bool "halley5_camera_board"
	depends on VIDEO_INGENIC_ISP
	default n
	help
	  Say Y here to enable support for halley5_camera_boards.

config RD_X2000_HALLEY5_CAMERA_1V0
	bool "halley5 camera driver for RD_X2000_HALLEY5_CAMERA_1V0"
	depends on HALLEY5_CAMERA_BOARD
	select INGENIC_ISP_CAMERA_AR0144
	select INGENIC_ISP_CAMERA_AR0234

config RD_X2000_HALLEY5_CAMERA_2V1
	bool "halley5 camera driver for RD_X2000_HALLEY5_CAMERA_2V1"
	depends on HALLEY5_CAMERA_BOARD
	select INGENIC_ISP_CAMERA_OV2735B
	select INGENIC_ISP_CAMERA_OV2735A

config RD_X2000_HALLEY5_CAMERA_4V2
	bool "halley5 camera driver for RD_X2000_HALLEY5_CAMERA_4V2"
	depends on HALLEY5_CAMERA_BOARD
	select INGENIC_ISP_CAMERA_OV2735B
	select INGENIC_ISP_CAMERA_OV2735A

config RD_X2000_HALLEY5_CAMERA_4V3
	bool "halley5 camera driver for RD_X2000_HALLEY5_CAMERA_4V3"
	depends on HALLEY5_CAMERA_BOARD
	select INGENIC_ISP_CAMERA_OV2735A
	select V4L2_FWNODE

config RD_X2000_HALLEY5_CAMERA_3V2
	bool "halley5 camera driver for RD_X2000_HALLEY5_CAMERA_3V2"
	depends on HALLEY5_CAMERA_BOARD
	select INGENIC_ISP_CAMERA_OV4689

choice
	prompt "ov4689 resolution and frame rate select"
	depends on RD_X2000_HALLEY5_CAMERA_3V2
	default OV4689_1080P_30FPS
	help
	Select ov4689 sensor's resolution and frame rate that driver supported.

config OV4689_1080P_120FPS
	bool "OV4689_1080P_120fps"
	depends on RD_X2000_HALLEY5_CAMERA_3V2 || CAMERA_V10

config OV4689_1080P_30FPS
	bool "OV4689_1080P_30fps"
	depends on RD_X2000_HALLEY5_CAMERA_3V2 || CAMERA_V10

config OV4689_2048X1520_30FPS
	bool "ov4689_2048x1520_30fps"
	depends on RD_X2000_HALLEY5_CAMERA_3V2 || CAMERA_V10
endchoice

config RD_X2000_HALLEY5_CAMERA_5V0
	bool "halley5 camera driver for RD_X2000_HALLEY5_CAMERA_5V0"
	depends on HALLEY5_CAMERA_BOARD
	select INGENIC_ISP_CAMERA_AR0144

config RD_X2500_HIPPO_CAMERA_1V1
	bool "halley5 camera driver for RD_X2500_HIPPO_CAMERA_1V1"
	depends on HALLEY5_CAMERA_BOARD
	select INGENIC_ISP_CAMERA_SC230AI

# gewu board
menuconfig GEWU_CAMERA_BOARD
	bool "gewu_camera_board"
	depends on VIDEO_INGENIC_ISP
	default n
	help
	  Say Y here to enable support for gewu_camera_boards.

config CAMERA_V10
	bool "gewu camera driver for CAMERA_1.0"
	depends on GEWU_CAMERA_BOARD
	select INGENIC_ISP_CAMERA_OV4689

choice
	prompt "ov4689 resolution and frame rate select"
	depends on CAMERA_V10
	default GEWU_OV4689_1080P_30FPS
	help
	Select ov4689 sensor's resolution and frame rate that driver supported.

config GEWU_OV4689_1080P_120FPS
	bool "OV4689_1080P_120fps"
	select OV4689_1080P_120FPS
	depends on CAMERA_V10

config GEWU_OV4689_1080P_30FPS
	bool "OV4689_1080P_30fps"
	select OV4689_1080P_30FPS
	depends on CAMERA_V10

config GEWU_OV4689_2048X1520_30FPS
	bool "ov4689_2048x1520_30fps"
	select OV4689_2048X1520_30FPS
	depends on CAMERA_V10
endchoice
```
